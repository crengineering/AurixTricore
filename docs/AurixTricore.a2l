/* ASAP2/A2L description of the AurixTricore XCP slave (firmware v1.3.0).
* All objects live at fixed addresses (TASKING __at), so this file does not
* depend on the link run:
* Xcp_Data (measurements) 0x70030000, 52 bytes, Measurements.h
* Xcp_Cal (calibration, RAM only) 0x70030100, 64 bytes, Diagnostics.h
* Xcp_Nvm (persistent, DFLASH) 0x70030200, 12 bytes, Nvm.h
* Xcp_Gpio (GPIO control, RAM only) 0x70030300, 52 bytes, gpio.h
* Transport: XCP on UDP/IP, port 5555, station 192.168.0.10.
* DAQ: dynamic, 1 list, event channel 0 = 100 ms task.
*/ ASAP2_VERSION 1 61
/begin PROJECT AurixTricore "TC399 TriBoard bare-metal project"
/begin MODULE XCP "AurixTricore XCP slave"
/begin MOD_COMMON "" BYTE_ORDER MSB_LAST ALIGNMENT_BYTE 1 ALIGNMENT_WORD 2 ALIGNMENT_LONG 4 ALIGNMENT_FLOAT32_IEEE 4 /end MOD_COMMON
/begin MOD_PAR "AurixTricore v1.3.0" /end MOD_PAR
/begin IF_DATA XCP
 /begin PROTOCOL_LAYER 0x0100 /* protocol layer version 1.0 */ 1000 1000 1000 1000 1000 1000 1000 /* T1..T7 timeouts [ms] */ 64 /* MAX_CTO */ 64 /* MAX_DTO */ BYTE_ORDER_MSB_LAST ADDRESS_GRANULARITY_BYTE OPTIONAL_CMD GET_ID OPTIONAL_CMD SET_MTA OPTIONAL_CMD UPLOAD OPTIONAL_CMD SHORT_UPLOAD OPTIONAL_CMD DOWNLOAD OPTIONAL_CMD SHORT_DOWNLOAD OPTIONAL_CMD GET_DAQ_PROCESSOR_INFO OPTIONAL_CMD GET_DAQ_RESOLUTION_INFO OPTIONAL_CMD FREE_DAQ OPTIONAL_CMD ALLOC_DAQ OPTIONAL_CMD ALLOC_ODT OPTIONAL_CMD ALLOC_ODT_ENTRY /end PROTOCOL_LAYER
 /begin DAQ DYNAMIC 1 /* MAX_DAQ */ 1 /* MAX_EVENT_CHANNEL */ 0 /* MIN_DAQ */ OPTIMISATION_TYPE_DEFAULT ADDRESS_EXTENSION_FREE IDENTIFICATION_FIELD_TYPE_ABSOLUTE GRANULARITY_ODT_ENTRY_SIZE_DAQ_BYTE 63 /* MAX_ODT_ENTRY_SIZE_DAQ */ NO_OVERLOAD_INDICATION /begin EVENT "Task100ms" "100ms" 0x0000 DAQ 0xFF 100 6 0x00 /end EVENT /end DAQ
 /begin XCP_ON_UDP_IP 0x0100 /* transport layer version 1.0 */ 5555 /* port */ ADDRESS "192.168.0.10" /end XCP_ON_UDP_IP
/end IF_DATA
/begin RECORD_LAYOUT RL_FLOAT32 FNC_VALUES 1 FLOAT32_IEEE ROW_DIR DIRECT /end RECORD_LAYOUT
/begin RECORD_LAYOUT RL_ULONG FNC_VALUES 1 ULONG ROW_DIR DIRECT /end RECORD_LAYOUT
/begin RECORD_LAYOUT RL_UBYTE FNC_VALUES 1 UBYTE ROW_DIR DIRECT /end RECORD_LAYOUT
/* Measurements: Xcp_Data @ 0x70030000 (see Measurements.h) */
/begin MEASUREMENT SwVersionMajor "software version major" UBYTE NO_COMPU_METHOD 0 0 0 255 ECU_ADDRESS 0x70030004 /end MEASUREMENT
/begin MEASUREMENT SwVersionMinor "software version minor" UBYTE NO_COMPU_METHOD 0 0 0 255 ECU_ADDRESS 0x70030005 /end MEASUREMENT
/begin MEASUREMENT SwVersionStep "software version step" UBYTE NO_COMPU_METHOD 0 0 0 255 ECU_ADDRESS 0x70030006 /end MEASUREMENT
/begin MEASUREMENT TickMs "board uptime" ULONG NO_COMPU_METHOD 0 0 0 4294967295 ECU_ADDRESS 0x70030008 PHYS_UNIT "ms" /end MEASUREMENT
/begin MEASUREMENT DieTemp_DTS "die temperature, PMS DTS (standby domain)" FLOAT32_IEEE NO_COMPU_METHOD 0 0 -50 170 ECU_ADDRESS 0x7003000C PHYS_UNIT "degC" /end MEASUREMENT
/begin MEASUREMENT DieTemp_DTSC "die temperature, SCU DTSC (core domain)" FLOAT32_IEEE NO_COMPU_METHOD 0 0 -50 170 ECU_ADDRESS 0x70030010 PHYS_UNIT "degC" /end MEASUREMENT
/begin MEASUREMENT VDD "1.25 V core rail (PMS monitor ADC)" FLOAT32_IEEE NO_COMPU_METHOD 0 0 0 2 ECU_ADDRESS 0x70030014 PHYS_UNIT "V" /end MEASUREMENT
/begin MEASUREMENT VDDP3 "3.3 V I/O rail (PMS monitor ADC)" FLOAT32_IEEE NO_COMPU_METHOD 0 0 0 5 ECU_ADDRESS 0x70030018 PHYS_UNIT "V" /end MEASUREMENT
/begin MEASUREMENT VEXT "5 V board supply (PMS monitor ADC)" FLOAT32_IEEE NO_COMPU_METHOD 0 0 0 6 ECU_ADDRESS 0x7003001C PHYS_UNIT "V" /end MEASUREMENT
/begin MEASUREMENT RawVdd "raw monitor ADC code VDD" UBYTE NO_COMPU_METHOD 0 0 0 255 ECU_ADDRESS 0x70030020 /end MEASUREMENT
/begin MEASUREMENT RawVddp3 "raw monitor ADC code VDDP3" UBYTE NO_COMPU_METHOD 0 0 0 255 ECU_ADDRESS 0x70030021 /end MEASUREMENT
/begin MEASUREMENT RawVext "raw monitor ADC code VEXT" UBYTE NO_COMPU_METHOD 0 0 0 255 ECU_ADDRESS 0x70030022 /end MEASUREMENT
/begin MEASUREMENT DiagStatus "diagnostics bitmask, see DIAGNOSTICS.md" ULONG NO_COMPU_METHOD 0 0 0 4294967295 ECU_ADDRESS 0x70030024 /end MEASUREMENT
/begin MEASUREMENT BaroPressure "BMP388 barometric pressure" FLOAT32_IEEE NO_COMPU_METHOD 0 0 0 200000 ECU_ADDRESS 0x70030028 PHYS_UNIT "Pa" /end MEASUREMENT
/begin MEASUREMENT BaroTemperature "BMP388 temperature" FLOAT32_IEEE NO_COMPU_METHOD 0 0 -40 85 ECU_ADDRESS 0x7003002C PHYS_UNIT "degC" /end MEASUREMENT
/begin MEASUREMENT BaroAltitude "pressure altitude vs standard 1013.25 hPa" FLOAT32_IEEE NO_COMPU_METHOD 0 0 -500 9000 ECU_ADDRESS 0x70030030 PHYS_UNIT "m" /end MEASUREMENT
/* MPU-6050 IMU (GY-521) on shared I2C0, firmware >= v1.10.0 */
/begin MEASUREMENT ImuPresent "1 if the MPU-6050 answered at init, else 0" UBYTE NO_COMPU_METHOD 0 0 0 1 ECU_ADDRESS 0x70030034 /end MEASUREMENT
/begin MEASUREMENT ImuAccelX "MPU-6050 acceleration X" FLOAT32_IEEE NO_COMPU_METHOD 0 0 -8 8 ECU_ADDRESS 0x70030038 PHYS_UNIT "g" /end MEASUREMENT
/begin MEASUREMENT ImuAccelY "MPU-6050 acceleration Y" FLOAT32_IEEE NO_COMPU_METHOD 0 0 -8 8 ECU_ADDRESS 0x7003003C PHYS_UNIT "g" /end MEASUREMENT
/begin MEASUREMENT ImuAccelZ "MPU-6050 acceleration Z" FLOAT32_IEEE NO_COMPU_METHOD 0 0 -8 8 ECU_ADDRESS 0x70030040 PHYS_UNIT "g" /end MEASUREMENT
/begin MEASUREMENT ImuGyroX "MPU-6050 angular rate X" FLOAT32_IEEE NO_COMPU_METHOD 0 0 -2000 2000 ECU_ADDRESS 0x70030044 PHYS_UNIT "deg/s" /end MEASUREMENT
/begin MEASUREMENT ImuGyroY "MPU-6050 angular rate Y" FLOAT32_IEEE NO_COMPU_METHOD 0 0 -2000 2000 ECU_ADDRESS 0x70030048 PHYS_UNIT "deg/s" /end MEASUREMENT
/begin MEASUREMENT ImuGyroZ "MPU-6050 angular rate Z" FLOAT32_IEEE NO_COMPU_METHOD 0 0 -2000 2000 ECU_ADDRESS 0x7003004C PHYS_UNIT "deg/s" /end MEASUREMENT
/begin MEASUREMENT ImuTemperature "MPU-6050 die temperature" FLOAT32_IEEE NO_COMPU_METHOD 0 0 -40 85 ECU_ADDRESS 0x70030050 PHYS_UNIT "degC" /end MEASUREMENT
/* individual diagnostics bits (BIT_MASK views on DiagStatus) */
/begin MEASUREMENT Diag_DTS_Undertemp "DTS temperature below dtsMin" ULONG NO_COMPU_METHOD 0 0 0 1 ECU_ADDRESS 0x70030024 BIT_MASK 0x00000001 /end MEASUREMENT
/begin MEASUREMENT Diag_DTS_Overtemp "DTS temperature above dtsMax" ULONG NO_COMPU_METHOD 0 0 0 1 ECU_ADDRESS 0x70030024 BIT_MASK 0x00000002 /end MEASUREMENT
/begin MEASUREMENT Diag_DTSC_Undertemp "DTSC temperature below dtscMin" ULONG NO_COMPU_METHOD 0 0 0 1 ECU_ADDRESS 0x70030024 BIT_MASK 0x00000004 /end MEASUREMENT
/begin MEASUREMENT Diag_DTSC_Overtemp "DTSC temperature above dtscMax" ULONG NO_COMPU_METHOD 0 0 0 1 ECU_ADDRESS 0x70030024 BIT_MASK 0x00000008 /end MEASUREMENT
/begin MEASUREMENT Diag_VDD_Undervolt "VDD below vddMin" ULONG NO_COMPU_METHOD 0 0 0 1 ECU_ADDRESS 0x70030024 BIT_MASK 0x00000010 /end MEASUREMENT
/begin MEASUREMENT Diag_VDD_Overvolt "VDD above vddMax" ULONG NO_COMPU_METHOD 0 0 0 1 ECU_ADDRESS 0x70030024 BIT_MASK 0x00000020 /end MEASUREMENT
/begin MEASUREMENT Diag_VDDP3_Undervolt "VDDP3 below vddp3Min" ULONG NO_COMPU_METHOD 0 0 0 1 ECU_ADDRESS 0x70030024 BIT_MASK 0x00000040 /end MEASUREMENT
/begin MEASUREMENT Diag_VDDP3_Overvolt "VDDP3 above vddp3Max" ULONG NO_COMPU_METHOD 0 0 0 1 ECU_ADDRESS 0x70030024 BIT_MASK 0x00000080 /end MEASUREMENT
/begin MEASUREMENT Diag_VEXT_Undervolt "VEXT below vextMin" ULONG NO_COMPU_METHOD 0 0 0 1 ECU_ADDRESS 0x70030024 BIT_MASK 0x00000100 /end MEASUREMENT
/begin MEASUREMENT Diag_VEXT_Overvolt "VEXT above vextMax" ULONG NO_COMPU_METHOD 0 0 0 1 ECU_ADDRESS 0x70030024 BIT_MASK 0x00000200 /end MEASUREMENT
/begin MEASUREMENT Diag_TempImplausible "delta DTS/DTSC above tempDeltaMax" ULONG NO_COMPU_METHOD 0 0 0 1 ECU_ADDRESS 0x70030024 BIT_MASK 0x00000400 /end MEASUREMENT
/begin MEASUREMENT Diag_UartDisconnected "no UART heartbeat from PC GUI for > 2 s" ULONG NO_COMPU_METHOD 0 0 0 1 ECU_ADDRESS 0x70030024 BIT_MASK 0x00000800 /end MEASUREMENT
/begin MEASUREMENT Diag_NvmFault "NVM corrupt at boot or last save failed" ULONG NO_COMPU_METHOD 0 0 0 1 ECU_ADDRESS 0x70030024 BIT_MASK 0x00001000 /end MEASUREMENT
/begin MEASUREMENT Diag_CalInvalid "calibration block magic broken, defaults reloaded" ULONG NO_COMPU_METHOD 0 0 0 1 ECU_ADDRESS 0x70030024 BIT_MASK 0x80000000 /end MEASUREMENT
/* Characteristics: Xcp_Cal @ 0x70030100 (see Diagnostics.h) */
/begin CHARACTERISTIC CAL_dtsMin "lower limit DTS temperature" VALUE 0x70030104 RL_FLOAT32 300 NO_COMPU_METHOD -50 170 PHYS_UNIT "degC" /end CHARACTERISTIC
/begin CHARACTERISTIC CAL_dtsMax "upper limit DTS temperature" VALUE 0x70030108 RL_FLOAT32 300 NO_COMPU_METHOD -50 170 PHYS_UNIT "degC" /end CHARACTERISTIC
/begin CHARACTERISTIC CAL_dtscMin "lower limit DTSC temperature" VALUE 0x7003010C RL_FLOAT32 300 NO_COMPU_METHOD -50 170 PHYS_UNIT "degC" /end CHARACTERISTIC
/begin CHARACTERISTIC CAL_dtscMax "upper limit DTSC temperature" VALUE 0x70030110 RL_FLOAT32 300 NO_COMPU_METHOD -50 170 PHYS_UNIT "degC" /end CHARACTERISTIC
/begin CHARACTERISTIC CAL_vddMin "lower limit VDD" VALUE 0x70030114 RL_FLOAT32 2 NO_COMPU_METHOD 0 2 PHYS_UNIT "V" /end CHARACTERISTIC
/begin CHARACTERISTIC CAL_vddMax "upper limit VDD" VALUE 0x70030118 RL_FLOAT32 2 NO_COMPU_METHOD 0 2 PHYS_UNIT "V" /end CHARACTERISTIC
/begin CHARACTERISTIC CAL_vddp3Min "lower limit VDDP3" VALUE 0x7003011C RL_FLOAT32 5 NO_COMPU_METHOD 0 5 PHYS_UNIT "V" /end CHARACTERISTIC
/begin CHARACTERISTIC CAL_vddp3Max "upper limit VDDP3" VALUE 0x70030120 RL_FLOAT32 5 NO_COMPU_METHOD 0 5 PHYS_UNIT "V" /end CHARACTERISTIC
/begin CHARACTERISTIC CAL_vextMin "lower limit VEXT" VALUE 0x70030124 RL_FLOAT32 6 NO_COMPU_METHOD 0 6 PHYS_UNIT "V" /end CHARACTERISTIC
/begin CHARACTERISTIC CAL_vextMax "upper limit VEXT" VALUE 0x70030128 RL_FLOAT32 6 NO_COMPU_METHOD 0 6 PHYS_UNIT "V" /end CHARACTERISTIC
/begin CHARACTERISTIC CAL_tempDeltaMax "max plausible delta DTS vs DTSC" VALUE 0x7003012C RL_FLOAT32 50 NO_COMPU_METHOD 0 50 PHYS_UNIT "K" /end CHARACTERISTIC
/begin CHARACTERISTIC CAL_debounceSec "fault debounce time (0.1 s resolution)" VALUE 0x70030130 RL_FLOAT32 60 NO_COMPU_METHOD 0 60 PHYS_UNIT "s" /end CHARACTERISTIC
/begin CHARACTERISTIC CAL_fsVdd "monitor ADC full scale VDD" VALUE 0x70030134 RL_FLOAT32 10 NO_COMPU_METHOD 0 10 PHYS_UNIT "V" /end CHARACTERISTIC
/begin CHARACTERISTIC CAL_fsVddp3 "monitor ADC full scale VDDP3" VALUE 0x70030138 RL_FLOAT32 10 NO_COMPU_METHOD 0 10 PHYS_UNIT "V" /end CHARACTERISTIC
/begin CHARACTERISTIC CAL_fsVext "monitor ADC full scale VEXT" VALUE 0x7003013C RL_FLOAT32 10 NO_COMPU_METHOD 0 10 PHYS_UNIT "V" /end CHARACTERISTIC
/* Persistent parameters: Xcp_Nvm @ 0x70030200 (see Nvm.h) */
/begin CHARACTERISTIC NVM_command "NVM command: 0x45564153 SAVE, 0x544C4644 load defaults; firmware clears to 0" VALUE 0x70030204 RL_ULONG 4294967295 NO_COMPU_METHOD 0 4294967295 /end CHARACTERISTIC
/begin CHARACTERISTIC NVM_userValue "persistent user scratch word (survives reset after SAVE)" VALUE 0x70030208 RL_ULONG 4294967295 NO_COMPU_METHOD 0 4294967295 /end CHARACTERISTIC
/* GPIO control: Xcp_Gpio @ 0x70030300, 52 bytes (see gpio.h) */
/* 0x04 state[16] 0=OFF, 1=ON (writable) */
/* 0x14 mode[16] 0=digital, 1=PWM, 2=reserved (READ-ONLY) */
/* 0x24 duty[16] PWM duty cycle 0..100 % (writable) */
/* Which pins are user-controllable and which are PWM is fixed in */
/* firmware (gpio_cfg.h); reserved pins (e.g. P00.0, diagnostics) are */
/* not exposed here and cannot be driven over XCP. For a PWM pin, */
/* state acts as an enable: OFF forces 0 % duty (output low), ON */
/* applies the duty value. Duty writes to digital pins are accepted */
/* but have no effect. */
/begin CHARACTERISTIC GPIO_P00_01_state "P00.1 output level (0=OFF/low, 1=ON/high)" VALUE 0x70030305 RL_UBYTE 1 NO_COMPU_METHOD 0 1 /end CHARACTERISTIC
/begin CHARACTERISTIC GPIO_P00_02_state "P00.2 output level (0=OFF/low, 1=ON/high)" VALUE 0x70030306 RL_UBYTE 1 NO_COMPU_METHOD 0 1 /end CHARACTERISTIC
/begin CHARACTERISTIC GPIO_P00_03_state "P00.3 output level (0=OFF/low, 1=ON/high)" VALUE 0x70030307 RL_UBYTE 1 NO_COMPU_METHOD 0 1 /end CHARACTERISTIC
/begin CHARACTERISTIC GPIO_P00_04_state "P00.4 output level (0=OFF/low, 1=ON/high)" VALUE 0x70030308 RL_UBYTE 1 NO_COMPU_METHOD 0 1 /end CHARACTERISTIC
/begin CHARACTERISTIC GPIO_P00_05_state "P00.5 output level (0=OFF/low, 1=ON/high)" VALUE 0x70030309 RL_UBYTE 1 NO_COMPU_METHOD 0 1 /end CHARACTERISTIC
/begin CHARACTERISTIC GPIO_P00_06_state "P00.6 output level (0=OFF/low, 1=ON/high)" VALUE 0x7003030A RL_UBYTE 1 NO_COMPU_METHOD 0 1 /end CHARACTERISTIC
/begin CHARACTERISTIC GPIO_P00_07_state "P00.7 output level (0=OFF/low, 1=ON/high)" VALUE 0x7003030B RL_UBYTE 1 NO_COMPU_METHOD 0 1 /end CHARACTERISTIC
/begin CHARACTERISTIC GPIO_P00_08_state "P00.8 output level (0=OFF/low, 1=ON/high)" VALUE 0x7003030C RL_UBYTE 1 NO_COMPU_METHOD 0 1 /end CHARACTERISTIC
/begin CHARACTERISTIC GPIO_P00_09_state "P00.9 output level (0=OFF/low, 1=ON/high)" VALUE 0x7003030D RL_UBYTE 1 NO_COMPU_METHOD 0 1 /end CHARACTERISTIC
/begin CHARACTERISTIC GPIO_P00_10_state "P00.10 output level (0=OFF/low, 1=ON/high)" VALUE 0x7003030E RL_UBYTE 1 NO_COMPU_METHOD 0 1 /end CHARACTERISTIC
/begin CHARACTERISTIC GPIO_P00_11_state "P00.11 output level (0=OFF/low, 1=ON/high)" VALUE 0x7003030F RL_UBYTE 1 NO_COMPU_METHOD 0 1 /end CHARACTERISTIC
/begin CHARACTERISTIC GPIO_P00_12_state "P00.12 output level (0=OFF/low, 1=ON/high)" VALUE 0x70030310 RL_UBYTE 1 NO_COMPU_METHOD 0 1 /end CHARACTERISTIC
/begin CHARACTERISTIC GPIO_P00_13_state "P00.13 output level (0=OFF/low, 1=ON/high)" VALUE 0x70030311 RL_UBYTE 1 NO_COMPU_METHOD 0 1 /end CHARACTERISTIC
/begin CHARACTERISTIC GPIO_P00_14_state "P00.14 output level (0=OFF/low, 1=ON/high)" VALUE 0x70030312 RL_UBYTE 1 NO_COMPU_METHOD 0 1 /end CHARACTERISTIC
/begin CHARACTERISTIC GPIO_P00_15_state "P00.15 output level (0=OFF/low, 1=ON/high)" VALUE 0x70030313 RL_UBYTE 1 NO_COMPU_METHOD 0 1 /end CHARACTERISTIC
/begin CHARACTERISTIC GPIO_P00_01_duty "P00.1 PWM duty cycle (effective only if pin is PWM in gpio_cfg.h)" VALUE 0x70030325 RL_UBYTE 100 NO_COMPU_METHOD 0 100 PHYS_UNIT "%" /end CHARACTERISTIC
/begin CHARACTERISTIC GPIO_P00_02_duty "P00.2 PWM duty cycle (effective only if pin is PWM in gpio_cfg.h)" VALUE 0x70030326 RL_UBYTE 100 NO_COMPU_METHOD 0 100 PHYS_UNIT "%" /end CHARACTERISTIC
/begin CHARACTERISTIC GPIO_P00_03_duty "P00.3 PWM duty cycle (effective only if pin is PWM in gpio_cfg.h)" VALUE 0x70030327 RL_UBYTE 100 NO_COMPU_METHOD 0 100 PHYS_UNIT "%" /end CHARACTERISTIC
/begin CHARACTERISTIC GPIO_P00_04_duty "P00.4 PWM duty cycle (effective only if pin is PWM in gpio_cfg.h)" VALUE 0x70030328 RL_UBYTE 100 NO_COMPU_METHOD 0 100 PHYS_UNIT "%" /end CHARACTERISTIC
/begin CHARACTERISTIC GPIO_P00_05_duty "P00.5 PWM duty cycle (effective only if pin is PWM in gpio_cfg.h)" VALUE 0x70030329 RL_UBYTE 100 NO_COMPU_METHOD 0 100 PHYS_UNIT "%" /end CHARACTERISTIC
/begin CHARACTERISTIC GPIO_P00_06_duty "P00.6 PWM duty cycle (effective only if pin is PWM in gpio_cfg.h)" VALUE 0x7003032A RL_UBYTE 100 NO_COMPU_METHOD 0 100 PHYS_UNIT "%" /end CHARACTERISTIC
/begin CHARACTERISTIC GPIO_P00_07_duty "P00.7 PWM duty cycle (effective only if pin is PWM in gpio_cfg.h)" VALUE 0x7003032B RL_UBYTE 100 NO_COMPU_METHOD 0 100 PHYS_UNIT "%" /end CHARACTERISTIC
/begin CHARACTERISTIC GPIO_P00_08_duty "P00.8 PWM duty cycle (effective only if pin is PWM in gpio_cfg.h)" VALUE 0x7003032C RL_UBYTE 100 NO_COMPU_METHOD 0 100 PHYS_UNIT "%" /end CHARACTERISTIC
/begin CHARACTERISTIC GPIO_P00_09_duty "P00.9 PWM duty cycle (effective only if pin is PWM in gpio_cfg.h)" VALUE 0x7003032D RL_UBYTE 100 NO_COMPU_METHOD 0 100 PHYS_UNIT "%" /end CHARACTERISTIC
/begin CHARACTERISTIC GPIO_P00_10_duty "P00.10 PWM duty cycle (effective only if pin is PWM in gpio_cfg.h)" VALUE 0x7003032E RL_UBYTE 100 NO_COMPU_METHOD 0 100 PHYS_UNIT "%" /end CHARACTERISTIC
/begin CHARACTERISTIC GPIO_P00_11_duty "P00.11 PWM duty cycle (effective only if pin is PWM in gpio_cfg.h)" VALUE 0x7003032F RL_UBYTE 100 NO_COMPU_METHOD 0 100 PHYS_UNIT "%" /end CHARACTERISTIC
/begin CHARACTERISTIC GPIO_P00_12_duty "P00.12 PWM duty cycle (effective only if pin is PWM in gpio_cfg.h)" VALUE 0x70030330 RL_UBYTE 100 NO_COMPU_METHOD 0 100 PHYS_UNIT "%" /end CHARACTERISTIC
/begin CHARACTERISTIC GPIO_P00_13_duty "P00.13 PWM duty cycle (effective only if pin is PWM in gpio_cfg.h)" VALUE 0x70030331 RL_UBYTE 100 NO_COMPU_METHOD 0 100 PHYS_UNIT "%" /end CHARACTERISTIC
/begin CHARACTERISTIC GPIO_P00_14_duty "P00.14 PWM duty cycle (effective only if pin is PWM in gpio_cfg.h)" VALUE 0x70030332 RL_UBYTE 100 NO_COMPU_METHOD 0 100 PHYS_UNIT "%" /end CHARACTERISTIC
/begin CHARACTERISTIC GPIO_P00_15_duty "P00.15 PWM duty cycle (effective only if pin is PWM in gpio_cfg.h)" VALUE 0x70030333 RL_UBYTE 100 NO_COMPU_METHOD 0 100 PHYS_UNIT "%" /end CHARACTERISTIC
/end MODULE
/end PROJECT
