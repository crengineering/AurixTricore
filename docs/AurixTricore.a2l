/* ASAP2/A2L description of the AurixTricore XCP slave (firmware v1.19.34).
* GENERATED by tools/gen_a2l.py -- do not edit by hand.
* Layout comes from the C structs; descriptions, units and limits come from
* tools/a2l_meta.json. Regenerate after changing either:
* python tools/gen_a2l.py
* CI runs 'python tools/gen_a2l.py --check' to catch a stale file.
* All objects live at fixed addresses (absolute linker groups in
* Lcf_Tasking_Tricore_Tc.lsl, docs/MEMORY_PLACEMENT.md T4), so this file
* does not depend on the link run -- addresses below are read from the
* .lsl, not typed:
* Xcp_Data (measurements) 0x70030000, 248 bytes, Measurements.h
* Xcp_Cal (calibration, RAM only) 0x70030100, 148 bytes, Diagnostics.h
* Xcp_Nvm (persistent, DFLASH) 0x70030200, 16 bytes, Nvm.h
* Xcp_Gpio (GPIO control, RAM only) 0x70030300, 52 bytes, gpio.h
* Xcp_Fusion (navigation state) 0x70030500, 252 bytes, Measurements.h
* Xcp_FusionCal (estimator tuning) 0x70030600, 104 bytes, FusionCal.h
* Xcp_Esc (ESC telemetry) 0x70030700, 256 bytes, Measurements.h
* Transport: XCP on UDP/IP, port 5555, station 192.168.0.10.
* DAQ: dynamic, 1 list, event channel 0 = 100 ms task.
*/ ASAP2_VERSION 1 61
/begin PROJECT AurixTricore "TC399 TriBoard bare-metal project"
/begin MODULE XCP "AurixTricore XCP slave"
/begin MOD_COMMON "" BYTE_ORDER MSB_LAST ALIGNMENT_BYTE 1 ALIGNMENT_WORD 2 ALIGNMENT_LONG 4 ALIGNMENT_FLOAT32_IEEE 4 /end MOD_COMMON
/begin MOD_PAR "AurixTricore v1.19.34" /end MOD_PAR
/begin IF_DATA XCP
 /begin PROTOCOL_LAYER 0x0100 /* protocol layer version 1.0 */ 1000 1000 1000 1000 1000 1000 1000 /* T1..T7 timeouts [ms] */ 64 /* MAX_CTO */ 64 /* MAX_DTO */ BYTE_ORDER_MSB_LAST ADDRESS_GRANULARITY_BYTE OPTIONAL_CMD GET_ID OPTIONAL_CMD SET_MTA OPTIONAL_CMD UPLOAD OPTIONAL_CMD SHORT_UPLOAD OPTIONAL_CMD DOWNLOAD OPTIONAL_CMD SHORT_DOWNLOAD OPTIONAL_CMD GET_DAQ_PROCESSOR_INFO OPTIONAL_CMD GET_DAQ_RESOLUTION_INFO OPTIONAL_CMD FREE_DAQ OPTIONAL_CMD ALLOC_DAQ OPTIONAL_CMD ALLOC_ODT OPTIONAL_CMD ALLOC_ODT_ENTRY /end PROTOCOL_LAYER
 /begin DAQ DYNAMIC 1 /* MAX_DAQ */ 1 /* MAX_EVENT_CHANNEL */ 0 /* MIN_DAQ */ OPTIMISATION_TYPE_DEFAULT ADDRESS_EXTENSION_FREE IDENTIFICATION_FIELD_TYPE_ABSOLUTE GRANULARITY_ODT_ENTRY_SIZE_DAQ_BYTE 63 /* MAX_ODT_ENTRY_SIZE_DAQ */ NO_OVERLOAD_INDICATION /begin EVENT "Task100ms" "100ms" 0x0000 DAQ 0xFF 100 6 0x00 /end EVENT /end DAQ
 /begin XCP_ON_UDP_IP 0x0100 /* transport layer version 1.0 */ 5555 /* port */ ADDRESS "192.168.0.10" /end XCP_ON_UDP_IP
/end IF_DATA
/begin RECORD_LAYOUT RL_FLOAT32 FNC_VALUES 1 FLOAT32_IEEE ROW_DIR DIRECT /end RECORD_LAYOUT
/begin RECORD_LAYOUT RL_ULONG FNC_VALUES 1 ULONG ROW_DIR DIRECT /end RECORD_LAYOUT
/begin RECORD_LAYOUT RL_UWORD FNC_VALUES 1 UWORD ROW_DIR DIRECT /end RECORD_LAYOUT
/begin RECORD_LAYOUT RL_UBYTE FNC_VALUES 1 UBYTE ROW_DIR DIRECT /end RECORD_LAYOUT
/* Measurements: Xcp_Data @ 0x70030000 (see Measurements.h) */
/begin MEASUREMENT SwVersionMajor "software version major" UBYTE NO_COMPU_METHOD 0 0 0 255 ECU_ADDRESS 0x70030004 /end MEASUREMENT
/begin MEASUREMENT SwVersionMinor "software version minor" UBYTE NO_COMPU_METHOD 0 0 0 255 ECU_ADDRESS 0x70030005 /end MEASUREMENT
/begin MEASUREMENT SwVersionStep "software version step" UBYTE NO_COMPU_METHOD 0 0 0 255 ECU_ADDRESS 0x70030006 /end MEASUREMENT
/begin MEASUREMENT TickMs "board uptime" ULONG NO_COMPU_METHOD 0 0 0 4294967295 ECU_ADDRESS 0x70030008 PHYS_UNIT "ms" /end MEASUREMENT
/begin MEASUREMENT DieTemp_DTS "die temperature, PMS DTS (standby domain)" FLOAT32_IEEE NO_COMPU_METHOD 0 0 -50 170 ECU_ADDRESS 0x7003000C PHYS_UNIT "degC" /end MEASUREMENT
/begin MEASUREMENT DieTemp_DTSC "die temperature, SCU DTSC (core domain)" FLOAT32_IEEE NO_COMPU_METHOD 0 0 -50 170 ECU_ADDRESS 0x70030010 PHYS_UNIT "degC" /end MEASUREMENT
/begin MEASUREMENT VDD "1.25 V core rail (PMS monitor ADC)" FLOAT32_IEEE NO_COMPU_METHOD 0 0 0 2 ECU_ADDRESS 0x70030014 PHYS_UNIT "V" /end MEASUREMENT
/begin MEASUREMENT VDDP3 "3.3 V I/O rail (PMS monitor ADC)" FLOAT32_IEEE NO_COMPU_METHOD 0 0 0 5 ECU_ADDRESS 0x70030018 PHYS_UNIT "V" /end MEASUREMENT
/begin MEASUREMENT VEXT "5 V board supply (PMS monitor ADC)" FLOAT32_IEEE NO_COMPU_METHOD 0 0 0 6 ECU_ADDRESS 0x7003001C PHYS_UNIT "V" /end MEASUREMENT
/begin MEASUREMENT RawVdd "raw monitor ADC code VDD" UBYTE NO_COMPU_METHOD 0 0 0 255 ECU_ADDRESS 0x70030020 /end MEASUREMENT
/begin MEASUREMENT RawVddp3 "raw monitor ADC code VDDP3" UBYTE NO_COMPU_METHOD 0 0 0 255 ECU_ADDRESS 0x70030021 /end MEASUREMENT
/begin MEASUREMENT RawVext "raw monitor ADC code VEXT" UBYTE NO_COMPU_METHOD 0 0 0 255 ECU_ADDRESS 0x70030022 /end MEASUREMENT
/begin MEASUREMENT BaroPresent "1 if the BMP581 answered at init, else 0" UBYTE NO_COMPU_METHOD 0 0 0 1 ECU_ADDRESS 0x70030023 /end MEASUREMENT
/begin MEASUREMENT DiagStatus "diagnostics bitmask, see DIAGNOSTICS.md" ULONG NO_COMPU_METHOD 0 0 0 4294967295 ECU_ADDRESS 0x70030024 /end MEASUREMENT
/begin MEASUREMENT BaroPressure "BMP581 barometric pressure" FLOAT32_IEEE NO_COMPU_METHOD 0 0 0 200000 ECU_ADDRESS 0x70030028 PHYS_UNIT "Pa" /end MEASUREMENT
/begin MEASUREMENT BaroTemperature "BMP581 temperature" FLOAT32_IEEE NO_COMPU_METHOD 0 0 -40 85 ECU_ADDRESS 0x7003002C PHYS_UNIT "degC" /end MEASUREMENT
/begin MEASUREMENT BaroAltitude "pressure altitude vs standard 1013.25 hPa" FLOAT32_IEEE NO_COMPU_METHOD 0 0 -500 9000 ECU_ADDRESS 0x70030030 PHYS_UNIT "m" /end MEASUREMENT
/begin MEASUREMENT ImuPresent "1 if the ICM-42688-P answered at init, else 0" UBYTE NO_COMPU_METHOD 0 0 0 1 ECU_ADDRESS 0x70030034 /end MEASUREMENT
/begin MEASUREMENT ImuAccelX "ICM-42688-P acceleration X" FLOAT32_IEEE NO_COMPU_METHOD 0 0 -8 8 ECU_ADDRESS 0x70030038 PHYS_UNIT "g" /end MEASUREMENT
/begin MEASUREMENT ImuAccelY "ICM-42688-P acceleration Y" FLOAT32_IEEE NO_COMPU_METHOD 0 0 -8 8 ECU_ADDRESS 0x7003003C PHYS_UNIT "g" /end MEASUREMENT
/begin MEASUREMENT ImuAccelZ "ICM-42688-P acceleration Z" FLOAT32_IEEE NO_COMPU_METHOD 0 0 -8 8 ECU_ADDRESS 0x70030040 PHYS_UNIT "g" /end MEASUREMENT
/begin MEASUREMENT ImuGyroX "ICM-42688-P angular rate X (RAW, no bias estimator)" FLOAT32_IEEE NO_COMPU_METHOD 0 0 -2000 2000 ECU_ADDRESS 0x70030044 PHYS_UNIT "deg/s" /end MEASUREMENT
/begin MEASUREMENT ImuGyroY "ICM-42688-P angular rate Y (RAW, no bias estimator)" FLOAT32_IEEE NO_COMPU_METHOD 0 0 -2000 2000 ECU_ADDRESS 0x70030048 PHYS_UNIT "deg/s" /end MEASUREMENT
/begin MEASUREMENT ImuGyroZ "ICM-42688-P angular rate Z (RAW, no bias estimator)" FLOAT32_IEEE NO_COMPU_METHOD 0 0 -2000 2000 ECU_ADDRESS 0x7003004C PHYS_UNIT "deg/s" /end MEASUREMENT
/begin MEASUREMENT ImuTemperature "ICM-42688-P die temperature" FLOAT32_IEEE NO_COMPU_METHOD 0 0 -40 85 ECU_ADDRESS 0x70030050 PHYS_UNIT "degC" /end MEASUREMENT
/begin MEASUREMENT Core0ExecTime "CPU0 busy time in the last 100 ms window" ULONG NO_COMPU_METHOD 0 0 0 100000 ECU_ADDRESS 0x70030054 PHYS_UNIT "us" /end MEASUREMENT
/begin MEASUREMENT Core1ExecTime "CPU0 busy time in the last 100 ms window" ULONG NO_COMPU_METHOD 0 0 0 100000 ECU_ADDRESS 0x70030058 PHYS_UNIT "us" /end MEASUREMENT
/begin MEASUREMENT Core2ExecTime "CPU0 busy time in the last 100 ms window" ULONG NO_COMPU_METHOD 0 0 0 100000 ECU_ADDRESS 0x7003005C PHYS_UNIT "us" /end MEASUREMENT
/begin MEASUREMENT Core3ExecTime "CPU0 busy time in the last 100 ms window" ULONG NO_COMPU_METHOD 0 0 0 100000 ECU_ADDRESS 0x70030060 PHYS_UNIT "us" /end MEASUREMENT
/begin MEASUREMENT Core4ExecTime "CPU0 busy time in the last 100 ms window" ULONG NO_COMPU_METHOD 0 0 0 100000 ECU_ADDRESS 0x70030064 PHYS_UNIT "us" /end MEASUREMENT
/begin MEASUREMENT Core5ExecTime "CPU0 busy time in the last 100 ms window" ULONG NO_COMPU_METHOD 0 0 0 100000 ECU_ADDRESS 0x70030068 PHYS_UNIT "us" /end MEASUREMENT
/begin MEASUREMENT Core0Load "CPU0 busy fraction of the window" UWORD NO_COMPU_METHOD 0 0 0 1000 ECU_ADDRESS 0x7003006C PHYS_UNIT "per mille" /end MEASUREMENT
/begin MEASUREMENT Core1Load "CPU0 busy fraction of the window" UWORD NO_COMPU_METHOD 0 0 0 1000 ECU_ADDRESS 0x7003006E PHYS_UNIT "per mille" /end MEASUREMENT
/begin MEASUREMENT Core2Load "CPU0 busy fraction of the window" UWORD NO_COMPU_METHOD 0 0 0 1000 ECU_ADDRESS 0x70030070 PHYS_UNIT "per mille" /end MEASUREMENT
/begin MEASUREMENT Core3Load "CPU0 busy fraction of the window" UWORD NO_COMPU_METHOD 0 0 0 1000 ECU_ADDRESS 0x70030072 PHYS_UNIT "per mille" /end MEASUREMENT
/begin MEASUREMENT Core4Load "CPU0 busy fraction of the window" UWORD NO_COMPU_METHOD 0 0 0 1000 ECU_ADDRESS 0x70030074 PHYS_UNIT "per mille" /end MEASUREMENT
/begin MEASUREMENT Core5Load "CPU0 busy fraction of the window" UWORD NO_COMPU_METHOD 0 0 0 1000 ECU_ADDRESS 0x70030076 PHYS_UNIT "per mille" /end MEASUREMENT
/begin MEASUREMENT Core0Alive "CPU0 liveness counter, frozen if the core hung" UWORD NO_COMPU_METHOD 0 0 0 65535 ECU_ADDRESS 0x70030078 /end MEASUREMENT
/begin MEASUREMENT Core1Alive "CPU0 liveness counter, frozen if the core hung" UWORD NO_COMPU_METHOD 0 0 0 65535 ECU_ADDRESS 0x7003007A /end MEASUREMENT
/begin MEASUREMENT Core2Alive "CPU0 liveness counter, frozen if the core hung" UWORD NO_COMPU_METHOD 0 0 0 65535 ECU_ADDRESS 0x7003007C /end MEASUREMENT
/begin MEASUREMENT Core3Alive "CPU0 liveness counter, frozen if the core hung" UWORD NO_COMPU_METHOD 0 0 0 65535 ECU_ADDRESS 0x7003007E /end MEASUREMENT
/begin MEASUREMENT Core4Alive "CPU0 liveness counter, frozen if the core hung" UWORD NO_COMPU_METHOD 0 0 0 65535 ECU_ADDRESS 0x70030080 /end MEASUREMENT
/begin MEASUREMENT Core5Alive "CPU0 liveness counter, frozen if the core hung" UWORD NO_COMPU_METHOD 0 0 0 65535 ECU_ADDRESS 0x70030082 /end MEASUREMENT
/begin MEASUREMENT EthBytesPerSec "Ethernet throughput, transmit and receive summed" ULONG NO_COMPU_METHOD 0 0 0 125000000 ECU_ADDRESS 0x70030084 PHYS_UNIT "B/s" /end MEASUREMENT
/begin MEASUREMENT EthUtilisation "link utilisation against the negotiated line rate" UWORD NO_COMPU_METHOD 0 0 0 1000 ECU_ADDRESS 0x70030088 PHYS_UNIT "per mille" /end MEASUREMENT
/begin MEASUREMENT EthLinkSpeed "negotiated link rate" UWORD NO_COMPU_METHOD 0 0 0 1000 ECU_ADDRESS 0x7003008A PHYS_UNIT "Mbit/s" /end MEASUREMENT
/begin MEASUREMENT MagPresent "1 if the MMC5983MA answered at init, else 0" UBYTE NO_COMPU_METHOD 0 0 0 1 ECU_ADDRESS 0x7003008C /end MEASUREMENT
/begin MEASUREMENT MagX "MMC5983MA magnetic field X" FLOAT32_IEEE NO_COMPU_METHOD 0 0 -8 8 ECU_ADDRESS 0x70030090 PHYS_UNIT "G" /end MEASUREMENT
/begin MEASUREMENT MagY "MMC5983MA magnetic field Y" FLOAT32_IEEE NO_COMPU_METHOD 0 0 -8 8 ECU_ADDRESS 0x70030094 PHYS_UNIT "G" /end MEASUREMENT
/begin MEASUREMENT MagZ "MMC5983MA magnetic field Z" FLOAT32_IEEE NO_COMPU_METHOD 0 0 -8 8 ECU_ADDRESS 0x70030098 PHYS_UNIT "G" /end MEASUREMENT
/begin MEASUREMENT MagFieldMagnitude "total field |B| - independent of orientation, ~0.48 G in Munich" FLOAT32_IEEE NO_COMPU_METHOD 0 0 0 8 ECU_ADDRESS 0x7003009C PHYS_UNIT "G" /end MEASUREMENT
/begin MEASUREMENT MagHeading "heading from X/Y - LEVEL ONLY, uncalibrated, no declination" FLOAT32_IEEE NO_COMPU_METHOD 0 0 0 360 ECU_ADDRESS 0x700300A0 PHYS_UNIT "deg" /end MEASUREMENT
/begin MEASUREMENT GnssPresent "1 if the NEO-M9N is answering (link alive), else 0" UBYTE NO_COMPU_METHOD 0 0 0 1 ECU_ADDRESS 0x700300A4 /end MEASUREMENT
/begin MEASUREMENT GnssYear "UTC year from UBX-NAV-PVT" UWORD NO_COMPU_METHOD 0 0 0 65535 ECU_ADDRESS 0x700300A6 PHYS_UNIT "y" /end MEASUREMENT
/begin MEASUREMENT GnssMonth "UTC month, 1..12" UBYTE NO_COMPU_METHOD 0 0 0 12 ECU_ADDRESS 0x700300A8 /end MEASUREMENT
/begin MEASUREMENT GnssDay "UTC day of month, 1..31" UBYTE NO_COMPU_METHOD 0 0 0 31 ECU_ADDRESS 0x700300A9 /end MEASUREMENT
/begin MEASUREMENT GnssHour "UTC hour, 0..23" UBYTE NO_COMPU_METHOD 0 0 0 23 ECU_ADDRESS 0x700300AA /end MEASUREMENT
/begin MEASUREMENT GnssMinute "UTC minute, 0..59" UBYTE NO_COMPU_METHOD 0 0 0 59 ECU_ADDRESS 0x700300AB /end MEASUREMENT
/begin MEASUREMENT GnssSecond "UTC second, 0..60 (60 during a leap second)" UBYTE NO_COMPU_METHOD 0 0 0 60 ECU_ADDRESS 0x700300AC /end MEASUREMENT
/begin MEASUREMENT GnssFixOk "1 = the receiver says the solution is valid (gnssFixOK set, invalidLlh clear). Necessary but NOT sufficient - use GnssNavOk" UBYTE NO_COMPU_METHOD 0 0 0 1 ECU_ADDRESS 0x700300AD /end MEASUREMENT
/begin MEASUREMENT GnssTimeOk "1 = UTC date and time are fully resolved. When 0 the date/time fields read 0 - the receiver's own free-running clock is NOT published, it looks like real data" UBYTE NO_COMPU_METHOD 0 0 0 1 ECU_ADDRESS 0x700300AE /end MEASUREMENT
/begin MEASUREMENT GnssNavOk "THE flag to gate sensor fusion on: fix valid AND 3D AND horizontal accuracy within 10 m. Independent of GnssTimeOk" UBYTE NO_COMPU_METHOD 0 0 0 1 ECU_ADDRESS 0x700300AF /end MEASUREMENT
/begin MEASUREMENT GnssRxBytes "NEO-M9N bytes received on ASCLIN4 since boot - the primary link-health signal" ULONG NO_COMPU_METHOD 0 0 0 4294967295 ECU_ADDRESS 0x700300B0 PHYS_UNIT "bytes" /end MEASUREMENT
/begin MEASUREMENT GnssSentences "complete, checksum-valid UBX frames assembled, any class (ACK, NAV-PVT, ...) -- was dead (never incremented) until issue #16, on a driver that had already moved from NMEA to UBX; rate follows CFG-RATE-NAV plus one ACK per CFG-VALSET at boot" ULONG NO_COMPU_METHOD 0 0 0 4294967295 ECU_ADDRESS 0x700300B4 /end MEASUREMENT
/begin MEASUREMENT GnssErrors "UBX frames whose length the state machine completed but whose checksum failed -- NOT ASCLIN hardware framing errors or FIFO overflow (see g_ring_buf_overflow_counter, not in Xcp_Data, for dropped ring bytes); must stay 0 on a healthy link" UWORD NO_COMPU_METHOD 0 0 0 65535 ECU_ADDRESS 0x700300B8 /end MEASUREMENT
/begin MEASUREMENT GnssFixType "fix quality from UBX-NAV-PVT (0=no fix, 2=2D, 3=3D, 4=GNSS+DR) -- reads 0 with no satellite visibility (normal indoors); see GnssNavOk for the fusion-ready gate" UBYTE NO_COMPU_METHOD 0 0 0 5 ECU_ADDRESS 0x700300BA /end MEASUREMENT
/begin MEASUREMENT GnssNumSats "satellites used in the solution, from UBX-NAV-PVT -- reads 0 with no satellite visibility (normal indoors)" UBYTE NO_COMPU_METHOD 0 0 0 32 ECU_ADDRESS 0x700300BB /end MEASUREMENT
/begin MEASUREMENT GnssLatitude "latitude from UBX-NAV-PVT, WGS84. Stored as float32 so ~0.4 m of the receiver's 1.1 cm resolution is lost - well below its ~1.5 m accuracy" FLOAT32_IEEE NO_COMPU_METHOD 0 0 -90 90 ECU_ADDRESS 0x700300BC PHYS_UNIT "deg" /end MEASUREMENT
/begin MEASUREMENT GnssLongitude "longitude from UBX-NAV-PVT, WGS84" FLOAT32_IEEE NO_COMPU_METHOD 0 0 -180 180 ECU_ADDRESS 0x700300C0 PHYS_UNIT "deg" /end MEASUREMENT
/begin MEASUREMENT GnssAltitude "height above mean sea level (NAV-PVT hMSL)" FLOAT32_IEEE NO_COMPU_METHOD 0 0 -1000 20000 ECU_ADDRESS 0x700300C4 PHYS_UNIT "m" /end MEASUREMENT
/begin MEASUREMENT GnssGroundSpeed "2-D ground speed (NAV-PVT gSpeed)" FLOAT32_IEEE NO_COMPU_METHOD 0 0 0 500 ECU_ADDRESS 0x700300C8 PHYS_UNIT "m/s" /end MEASUREMENT
/begin MEASUREMENT GnssHeading "2-D heading of motion (NAV-PVT headMot); meaningless when stationary" FLOAT32_IEEE NO_COMPU_METHOD 0 0 -180 360 ECU_ADDRESS 0x700300CC PHYS_UNIT "deg" /end MEASUREMENT
/begin MEASUREMENT GnssHAccuracy "horizontal accuracy estimate (NAV-PVT hAcc) - the number that says whether the fix is trustworthy" FLOAT32_IEEE NO_COMPU_METHOD 0 0 0 10000 ECU_ADDRESS 0x700300D0 PHYS_UNIT "m" /end MEASUREMENT
/begin MEASUREMENT GnssVAccuracy "vertical accuracy estimate (NAV-PVT vAcc). Typically 1.5-2x worse than horizontal - all satellites are above the receiver, so the geometry for the vertical component is poor" FLOAT32_IEEE NO_COMPU_METHOD 0 0 0 10000 ECU_ADDRESS 0x700300D4 PHYS_UNIT "m" /end MEASUREMENT
/begin MEASUREMENT FusionDt "measured interval between IMU task runs, the dt the filter integrates with. Nominal 0.020 s; measured rather than assumed so scheduler jitter cannot bias the integral" FLOAT32_IEEE NO_COMPU_METHOD 0 0 -1e12 1e12 ECU_ADDRESS 0x700300D8 PHYS_UNIT "s" /end MEASUREMENT
/begin MEASUREMENT FusionAccelDown "acceleration along NED down with gravity removed, the filter's input. Zero at rest and level; NEGATIVE while accelerating upward. LEVEL-SCAFFOLD ONLY until an attitude estimate exists" FLOAT32_IEEE NO_COMPU_METHOD 0 0 -1e12 1e12 ECU_ADDRESS 0x700300DC PHYS_UNIT "m/s^2" /end MEASUREMENT
/begin MEASUREMENT FusionVelocityDown "estimated velocity along NED down. POSITIVE IS DOWN: sinking is positive, climbing negative" FLOAT32_IEEE NO_COMPU_METHOD 0 0 -1e12 1e12 ECU_ADDRESS 0x700300E0 PHYS_UNIT "m/s" /end MEASUREMENT
/begin MEASUREMENT FusionAltitudeDown "estimated position along NED down, relative to the first valid barometer sample. POSITIVE IS DOWN, so climbing makes this go negative" FLOAT32_IEEE NO_COMPU_METHOD 0 0 -1e12 1e12 ECU_ADDRESS 0x700300E4 PHYS_UNIT "m" /end MEASUREMENT
/begin MEASUREMENT FusionInnovation "barometer innovation: measured altitude minus the filter's prediction. Zero-mean noise means the filter is consistent; a constant offset means the model is missing a term (in stage 3 that offset IS the un-modelled accelerometer bias)" FLOAT32_IEEE NO_COMPU_METHOD 0 0 -1e12 1e12 ECU_ADDRESS 0x700300E8 PHYS_UNIT "m" /end MEASUREMENT
/begin MEASUREMENT FusionVarAltitude "filter variance of a_d [m^2]. Grows on every predict, shrinks on every barometer correction; it should settle rather than run away" FLOAT32_IEEE NO_COMPU_METHOD 0 0 -1e12 1e12 ECU_ADDRESS 0x700300EC PHYS_UNIT "m^2" /end MEASUREMENT
/begin MEASUREMENT FusionBaroRejects "barometer samples rejected by the 5-sigma outlier gate. A rising count is a sensor fault, not a tuning knob" ULONG NO_COMPU_METHOD 0 0 0 4294967295 ECU_ADDRESS 0x700300F0 PHYS_UNIT "-" /end MEASUREMENT
/begin MEASUREMENT FusionResets "filter re-acquisitions: the barometer was rejected for 0.5 s straight, so the state was reloaded from it. Non-zero means the filter diverged and recovered -- investigate what threw it off" ULONG NO_COMPU_METHOD 0 0 0 4294967295 ECU_ADDRESS 0x700300F4 PHYS_UNIT "-" /end MEASUREMENT
/* individual diagnostics bits (BIT_MASK views on DiagStatus) */
/begin MEASUREMENT Diag_DTS_Undertemp "DTS temperature below dtsMin" ULONG NO_COMPU_METHOD 0 0 0 1 ECU_ADDRESS 0x70030024 BIT_MASK 0x00000001 /end MEASUREMENT
/begin MEASUREMENT Diag_DTS_Overtemp "DTS temperature above dtsMax" ULONG NO_COMPU_METHOD 0 0 0 1 ECU_ADDRESS 0x70030024 BIT_MASK 0x00000002 /end MEASUREMENT
/begin MEASUREMENT Diag_DTSC_Undertemp "DTSC temperature below dtscMin" ULONG NO_COMPU_METHOD 0 0 0 1 ECU_ADDRESS 0x70030024 BIT_MASK 0x00000004 /end MEASUREMENT
/begin MEASUREMENT Diag_DTSC_Overtemp "DTSC temperature above dtscMax" ULONG NO_COMPU_METHOD 0 0 0 1 ECU_ADDRESS 0x70030024 BIT_MASK 0x00000008 /end MEASUREMENT
/begin MEASUREMENT Diag_VDD_Undervolt "VDD below vddMin" ULONG NO_COMPU_METHOD 0 0 0 1 ECU_ADDRESS 0x70030024 BIT_MASK 0x00000010 /end MEASUREMENT
/begin MEASUREMENT Diag_VDD_Overvolt "VDD above vddMax" ULONG NO_COMPU_METHOD 0 0 0 1 ECU_ADDRESS 0x70030024 BIT_MASK 0x00000020 /end MEASUREMENT
/begin MEASUREMENT Diag_VDDP3_Undervolt "VDDP3 below vddp3Min" ULONG NO_COMPU_METHOD 0 0 0 1 ECU_ADDRESS 0x70030024 BIT_MASK 0x00000040 /end MEASUREMENT
/begin MEASUREMENT Diag_VDDP3_Overvolt "VDDP3 above vddp3Max" ULONG NO_COMPU_METHOD 0 0 0 1 ECU_ADDRESS 0x70030024 BIT_MASK 0x00000080 /end MEASUREMENT
/begin MEASUREMENT Diag_VEXT_Undervolt "VEXT below vextMin" ULONG NO_COMPU_METHOD 0 0 0 1 ECU_ADDRESS 0x70030024 BIT_MASK 0x00000100 /end MEASUREMENT
/begin MEASUREMENT Diag_VEXT_Overvolt "VEXT above vextMax" ULONG NO_COMPU_METHOD 0 0 0 1 ECU_ADDRESS 0x70030024 BIT_MASK 0x00000200 /end MEASUREMENT
/begin MEASUREMENT Diag_TempImplausible "delta DTS/DTSC above tempDeltaMax" ULONG NO_COMPU_METHOD 0 0 0 1 ECU_ADDRESS 0x70030024 BIT_MASK 0x00000400 /end MEASUREMENT
/begin MEASUREMENT Diag_UartDisconnected "no UART heartbeat from PC GUI for > 2 s" ULONG NO_COMPU_METHOD 0 0 0 1 ECU_ADDRESS 0x70030024 BIT_MASK 0x00000800 /end MEASUREMENT
/begin MEASUREMENT Diag_NvmFault "NVM corrupt at boot or last save failed" ULONG NO_COMPU_METHOD 0 0 0 1 ECU_ADDRESS 0x70030024 BIT_MASK 0x00001000 /end MEASUREMENT
/begin MEASUREMENT Diag_I2cSclStuck "I2C0 SCL held low: short to GND or a slave stretching the clock" ULONG NO_COMPU_METHOD 0 0 0 1 ECU_ADDRESS 0x70030024 BIT_MASK 0x00002000 /end MEASUREMENT
/begin MEASUREMENT Diag_I2cSdaStuck "I2C0 SDA held low: short to GND or a slave jammed mid-byte" ULONG NO_COMPU_METHOD 0 0 0 1 ECU_ADDRESS 0x70030024 BIT_MASK 0x00004000 /end MEASUREMENT
/begin MEASUREMENT Diag_BaroNoResponse "BMP581 never answered since boot: wiring, address or dead part" ULONG NO_COMPU_METHOD 0 0 0 1 ECU_ADDRESS 0x70030024 BIT_MASK 0x00008000 /end MEASUREMENT
/begin MEASUREMENT Diag_BaroTimeout "BMP581 answered before and is now silent for > 1 s" ULONG NO_COMPU_METHOD 0 0 0 1 ECU_ADDRESS 0x70030024 BIT_MASK 0x00010000 /end MEASUREMENT
/begin MEASUREMENT Diag_BaroStuckData "BMP581 bus healthy but the value stopped changing for > 5 s" ULONG NO_COMPU_METHOD 0 0 0 1 ECU_ADDRESS 0x70030024 BIT_MASK 0x00020000 /end MEASUREMENT
/begin MEASUREMENT Diag_BaroImplausible "BMP581 outside 300-1200 hPa or -40..85 degC" ULONG NO_COMPU_METHOD 0 0 0 1 ECU_ADDRESS 0x70030024 BIT_MASK 0x00040000 /end MEASUREMENT
/begin MEASUREMENT Diag_ImuNoResponse "ICM-42688-P never answered since boot: level shifters, CS, SPI mode or MRST pad" ULONG NO_COMPU_METHOD 0 0 0 1 ECU_ADDRESS 0x70030024 BIT_MASK 0x00080000 /end MEASUREMENT
/begin MEASUREMENT Diag_ImuTimeout "ICM-42688-P answered before and is now silent for > 1 s" ULONG NO_COMPU_METHOD 0 0 0 1 ECU_ADDRESS 0x70030024 BIT_MASK 0x00100000 /end MEASUREMENT
/begin MEASUREMENT Diag_ImuStuckData "ICM-42688-P bus healthy but the sample block stopped changing for > 5 s" ULONG NO_COMPU_METHOD 0 0 0 1 ECU_ADDRESS 0x70030024 BIT_MASK 0x00200000 /end MEASUREMENT
/begin MEASUREMENT Diag_ImuImplausible "ICM-42688-P |a| outside 0.05..17 g or temperature outside -40..85 degC" ULONG NO_COMPU_METHOD 0 0 0 1 ECU_ADDRESS 0x70030024 BIT_MASK 0x00400000 /end MEASUREMENT
/begin MEASUREMENT Diag_MagNoResponse "MMC5983MA never answered since boot: wiring, or CS not tied to +3V3" ULONG NO_COMPU_METHOD 0 0 0 1 ECU_ADDRESS 0x70030024 BIT_MASK 0x00800000 /end MEASUREMENT
/begin MEASUREMENT Diag_MagTimeout "MMC5983MA answered before and is now silent for > 1 s" ULONG NO_COMPU_METHOD 0 0 0 1 ECU_ADDRESS 0x70030024 BIT_MASK 0x01000000 /end MEASUREMENT
/begin MEASUREMENT Diag_MagStuckData "MMC5983MA bus healthy but the field stopped changing for > 5 s" ULONG NO_COMPU_METHOD 0 0 0 1 ECU_ADDRESS 0x70030024 BIT_MASK 0x02000000 /end MEASUREMENT
/begin MEASUREMENT Diag_MagImplausible "MMC5983MA |B| outside 0.15..2.0 G - wrong scaling or axis assembly" ULONG NO_COMPU_METHOD 0 0 0 1 ECU_ADDRESS 0x70030024 BIT_MASK 0x04000000 /end MEASUREMENT
/begin MEASUREMENT Diag_GnssNoResponse "NEO-M9N never sent a byte since boot: wiring, baud rate, or module unpowered" ULONG NO_COMPU_METHOD 0 0 0 1 ECU_ADDRESS 0x70030024 BIT_MASK 0x08000000 /end MEASUREMENT
/begin MEASUREMENT Diag_GnssTimeout "NEO-M9N was streaming and has now been silent for > 2 s" ULONG NO_COMPU_METHOD 0 0 0 1 ECU_ADDRESS 0x70030024 BIT_MASK 0x10000000 /end MEASUREMENT
/begin MEASUREMENT Diag_GnssStuckData "GnssRxBytes stopped advancing - for a stream device this is the same fault as Timeout" ULONG NO_COMPU_METHOD 0 0 0 1 ECU_ADDRESS 0x70030024 BIT_MASK 0x20000000 /end MEASUREMENT
/begin MEASUREMENT Diag_GnssImplausible "NEO-M9N data quality fault - NOT YET WIRED, the plausible input is hardcoded TRUE" ULONG NO_COMPU_METHOD 0 0 0 1 ECU_ADDRESS 0x70030024 BIT_MASK 0x40000000 /end MEASUREMENT
/begin MEASUREMENT Diag_CalInvalid "calibration block magic broken, defaults reloaded" ULONG NO_COMPU_METHOD 0 0 0 1 ECU_ADDRESS 0x70030024 BIT_MASK 0x80000000 /end MEASUREMENT
/* Calibration: Xcp_Cal @ 0x70030100, RAM only (see Diagnostics.h) */
/begin CHARACTERISTIC CAL_dtsMin "lower limit DTS temperature" VALUE 0x70030104 RL_FLOAT32 300 NO_COMPU_METHOD -50 170 PHYS_UNIT "degC" /end CHARACTERISTIC
/begin CHARACTERISTIC CAL_dtsMax "upper limit DTS temperature" VALUE 0x70030108 RL_FLOAT32 300 NO_COMPU_METHOD -50 170 PHYS_UNIT "degC" /end CHARACTERISTIC
/begin CHARACTERISTIC CAL_dtscMin "lower limit DTSC temperature" VALUE 0x7003010C RL_FLOAT32 300 NO_COMPU_METHOD -50 170 PHYS_UNIT "degC" /end CHARACTERISTIC
/begin CHARACTERISTIC CAL_dtscMax "upper limit DTSC temperature" VALUE 0x70030110 RL_FLOAT32 300 NO_COMPU_METHOD -50 170 PHYS_UNIT "degC" /end CHARACTERISTIC
/begin CHARACTERISTIC CAL_vddMin "lower limit VDD" VALUE 0x70030114 RL_FLOAT32 2 NO_COMPU_METHOD 0 2 PHYS_UNIT "V" /end CHARACTERISTIC
/begin CHARACTERISTIC CAL_vddMax "upper limit VDD" VALUE 0x70030118 RL_FLOAT32 2 NO_COMPU_METHOD 0 2 PHYS_UNIT "V" /end CHARACTERISTIC
/begin CHARACTERISTIC CAL_vddp3Min "lower limit VDDP3" VALUE 0x7003011C RL_FLOAT32 5 NO_COMPU_METHOD 0 5 PHYS_UNIT "V" /end CHARACTERISTIC
/begin CHARACTERISTIC CAL_vddp3Max "upper limit VDDP3" VALUE 0x70030120 RL_FLOAT32 5 NO_COMPU_METHOD 0 5 PHYS_UNIT "V" /end CHARACTERISTIC
/begin CHARACTERISTIC CAL_vextMin "lower limit VEXT" VALUE 0x70030124 RL_FLOAT32 6 NO_COMPU_METHOD 0 6 PHYS_UNIT "V" /end CHARACTERISTIC
/begin CHARACTERISTIC CAL_vextMax "upper limit VEXT" VALUE 0x70030128 RL_FLOAT32 6 NO_COMPU_METHOD 0 6 PHYS_UNIT "V" /end CHARACTERISTIC
/begin CHARACTERISTIC CAL_tempDeltaMax "max plausible delta DTS vs DTSC" VALUE 0x7003012C RL_FLOAT32 50 NO_COMPU_METHOD 0 50 PHYS_UNIT "K" /end CHARACTERISTIC
/begin CHARACTERISTIC CAL_debounceSec "fault debounce time (0.1 s resolution)" VALUE 0x70030130 RL_FLOAT32 60 NO_COMPU_METHOD 0 60 PHYS_UNIT "s" /end CHARACTERISTIC
/begin CHARACTERISTIC CAL_fsVdd "monitor ADC full scale VDD" VALUE 0x70030134 RL_FLOAT32 10 NO_COMPU_METHOD 0 10 PHYS_UNIT "V" /end CHARACTERISTIC
/begin CHARACTERISTIC CAL_fsVddp3 "monitor ADC full scale VDDP3" VALUE 0x70030138 RL_FLOAT32 10 NO_COMPU_METHOD 0 10 PHYS_UNIT "V" /end CHARACTERISTIC
/begin CHARACTERISTIC CAL_fsVext "monitor ADC full scale VEXT" VALUE 0x7003013C RL_FLOAT32 10 NO_COMPU_METHOD 0 10 PHYS_UNIT "V" /end CHARACTERISTIC
/begin CHARACTERISTIC CAL_motorCmd "arming word: 1 = ARM, 0 = DISARM; the firmware clears it on every exit from ARMED" VALUE 0x70030140 RL_ULONG 1 NO_COMPU_METHOD 0 1 /end CHARACTERISTIC
/begin CHARACTERISTIC CAL_motorManual "1 = manual setpoint source (CAL_motorManualSp_n) instead of the flight controller; cleared with CAL_motorCmd on every exit from ARMED" VALUE 0x70030144 RL_ULONG 1 NO_COMPU_METHOD 0 1 /end CHARACTERISTIC
/begin CHARACTERISTIC CAL_motorManualSp_M1 "manual DShot value for motor M1: 0 = stop, 48..2047 = throttle; only used while CAL_motorManual is set and the vehicle is ARMED; zeroed on every exit from ARMED" VALUE 0x70030148 RL_UWORD 2047 NO_COMPU_METHOD 0 2047 /end CHARACTERISTIC
/begin CHARACTERISTIC CAL_motorManualSp_M2 "manual DShot value for motor M2: 0 = stop, 48..2047 = throttle; only used while CAL_motorManual is set and the vehicle is ARMED; zeroed on every exit from ARMED" VALUE 0x7003014A RL_UWORD 2047 NO_COMPU_METHOD 0 2047 /end CHARACTERISTIC
/begin CHARACTERISTIC CAL_motorManualSp_M3 "manual DShot value for motor M3: 0 = stop, 48..2047 = throttle; only used while CAL_motorManual is set and the vehicle is ARMED; zeroed on every exit from ARMED" VALUE 0x7003014C RL_UWORD 2047 NO_COMPU_METHOD 0 2047 /end CHARACTERISTIC
/begin CHARACTERISTIC CAL_motorManualSp_M4 "manual DShot value for motor M4: 0 = stop, 48..2047 = throttle; only used while CAL_motorManual is set and the vehicle is ARMED; zeroed on every exit from ARMED" VALUE 0x7003014E RL_UWORD 2047 NO_COMPU_METHOD 0 2047 /end CHARACTERISTIC
/begin CHARACTERISTIC CAL_motorSpMax "DShot throttle ceiling for every setpoint source, 48..2047; default 1600 after every reset (50 A criterion, SYS2-PWR-001); raise to 2047 for thrust-rig runs only; an out-of-range write is reverted to the last valid value" VALUE 0x70030150 RL_UWORD 2047 NO_COMPU_METHOD 48 2047 /end CHARACTERISTIC
/begin CHARACTERISTIC CAL_motorSpMode "unit of CAL_motorManualSp_Mn: 0 = DShot throttle 48..2047, 1 = rpm through the thrust-rig lookup table in motor.c (0 = stop, 1..8257 rpm -> 48..1600, above 8257 -> 1600); default 1 after every reset; the flight-controller path always uses the table" VALUE 0x70030152 RL_UWORD 1 NO_COMPU_METHOD 0 1 /end CHARACTERISTIC
/begin CHARACTERISTIC CAL_ctrlMode "flight controller on the motor path: 0 = shadow (computed and logged, motors get no request), 1 = the controller drives the motors; accepted only while ARMED (the firmware writes 0 in every other state, when the request is unusable: flight core silent, estimate invalid, tilt limit, and when CAL_motorManual is set: after manual it must be engaged again)" VALUE 0x70030154 RL_ULONG 1 NO_COMPU_METHOD 0 1 /end CHARACTERISTIC
/begin CHARACTERISTIC CAL_ctrlThrustN "collective thrust of the flight controller, set by hand (no altitude loop yet); only kept while ARMED: the firmware resets it to 0 in every other state and whenever CAL_ctrlMode is dropped" VALUE 0x70030158 RL_FLOAT32 40 NO_COMPU_METHOD 0 40 PHYS_UNIT "N" /end CHARACTERISTIC
/begin CHARACTERISTIC CAL_ctrlTiltMaxDeg "tilt limit: |roll| or |pitch| beyond this drops CAL_ctrlMode to 0 (motors stop); default 30, out of range reads as 30" VALUE 0x7003015C RL_FLOAT32 90 NO_COMPU_METHOD 0 90 PHYS_UNIT "deg" /end CHARACTERISTIC
/begin CHARACTERISTIC CAL_ctrlRpmMin "lowest rotor-speed request per motor from the flight controller (a request of 0 would stop the motor); default 1300; outside 129..3000 reads as 1300" VALUE 0x70030160 RL_FLOAT32 3000 NO_COMPU_METHOD 129 3000 PHYS_UNIT "rpm" /end CHARACTERISTIC
/begin CHARACTERISTIC CAL_ctrlOmKp_0 "attitude loop P gain (index 0 roll, 1 pitch, 2 yaw); rig start value, yaw 0; a value outside the limits reads as 0" VALUE 0x70030164 RL_FLOAT32 20 NO_COMPU_METHOD 0 20 PHYS_UNIT "1/s" /end CHARACTERISTIC
/begin CHARACTERISTIC CAL_ctrlOmKp_1 "attitude loop P gain (index 0 roll, 1 pitch, 2 yaw); rig start value, yaw 0; a value outside the limits reads as 0" VALUE 0x70030168 RL_FLOAT32 20 NO_COMPU_METHOD 0 20 PHYS_UNIT "1/s" /end CHARACTERISTIC
/begin CHARACTERISTIC CAL_ctrlOmKp_2 "attitude loop P gain (index 0 roll, 1 pitch, 2 yaw); rig start value, yaw 0; a value outside the limits reads as 0" VALUE 0x7003016C RL_FLOAT32 20 NO_COMPU_METHOD 0 20 PHYS_UNIT "1/s" /end CHARACTERISTIC
/begin CHARACTERISTIC CAL_ctrlTauKp_0 "rate loop P gain (index 0 roll, 1 pitch, 2 yaw); rig start value, yaw 0; a value outside the limits reads as 0" VALUE 0x70030170 RL_FLOAT32 1 NO_COMPU_METHOD 0 1 PHYS_UNIT "Nm/(rad/s)" /end CHARACTERISTIC
/begin CHARACTERISTIC CAL_ctrlTauKp_1 "rate loop P gain (index 0 roll, 1 pitch, 2 yaw); rig start value, yaw 0; a value outside the limits reads as 0" VALUE 0x70030174 RL_FLOAT32 1 NO_COMPU_METHOD 0 1 PHYS_UNIT "Nm/(rad/s)" /end CHARACTERISTIC
/begin CHARACTERISTIC CAL_ctrlTauKp_2 "rate loop P gain (index 0 roll, 1 pitch, 2 yaw); rig start value, yaw 0; a value outside the limits reads as 0" VALUE 0x70030178 RL_FLOAT32 1 NO_COMPU_METHOD 0 1 PHYS_UNIT "Nm/(rad/s)" /end CHARACTERISTIC
/begin CHARACTERISTIC CAL_ctrlTauKi_0 "rate loop I gain (index 0 roll, 1 pitch, 2 yaw); rig start value, yaw 0; a value outside the limits reads as 0" VALUE 0x7003017C RL_FLOAT32 2 NO_COMPU_METHOD 0 2 PHYS_UNIT "Nm/rad" /end CHARACTERISTIC
/begin CHARACTERISTIC CAL_ctrlTauKi_1 "rate loop I gain (index 0 roll, 1 pitch, 2 yaw); rig start value, yaw 0; a value outside the limits reads as 0" VALUE 0x70030180 RL_FLOAT32 2 NO_COMPU_METHOD 0 2 PHYS_UNIT "Nm/rad" /end CHARACTERISTIC
/begin CHARACTERISTIC CAL_ctrlTauKi_2 "rate loop I gain (index 0 roll, 1 pitch, 2 yaw); rig start value, yaw 0; a value outside the limits reads as 0" VALUE 0x70030184 RL_FLOAT32 2 NO_COMPU_METHOD 0 2 PHYS_UNIT "Nm/rad" /end CHARACTERISTIC
/begin CHARACTERISTIC CAL_ctrlAttSp_0 "attitude setpoint of the flight controller (index 0 roll, 1 pitch, 2 yaw): roll/pitch limited to +/- CAL_ctrlTiltMaxDeg; yaw 0..360 = heading to hold (shortest way round), anything else (-1) = keep the current heading; only kept while ARMED, the firmware resets them to 0 / 0 / -1 in every other state and whenever CAL_ctrlMode is dropped" VALUE 0x70030188 RL_FLOAT32 360 NO_COMPU_METHOD -90 360 PHYS_UNIT "deg" /end CHARACTERISTIC
/begin CHARACTERISTIC CAL_ctrlAttSp_1 "attitude setpoint of the flight controller (index 0 roll, 1 pitch, 2 yaw): roll/pitch limited to +/- CAL_ctrlTiltMaxDeg; yaw 0..360 = heading to hold (shortest way round), anything else (-1) = keep the current heading; only kept while ARMED, the firmware resets them to 0 / 0 / -1 in every other state and whenever CAL_ctrlMode is dropped" VALUE 0x7003018C RL_FLOAT32 360 NO_COMPU_METHOD -90 360 PHYS_UNIT "deg" /end CHARACTERISTIC
/begin CHARACTERISTIC CAL_ctrlAttSp_2 "attitude setpoint of the flight controller (index 0 roll, 1 pitch, 2 yaw): roll/pitch limited to +/- CAL_ctrlTiltMaxDeg; yaw 0..360 = heading to hold (shortest way round), anything else (-1) = keep the current heading; only kept while ARMED, the firmware resets them to 0 / 0 / -1 in every other state and whenever CAL_ctrlMode is dropped" VALUE 0x70030190 RL_FLOAT32 360 NO_COMPU_METHOD -90 360 PHYS_UNIT "deg" /end CHARACTERISTIC
/* Persistent: Xcp_Nvm @ 0x70030200, DFLASH (see Nvm.h) */
/begin CHARACTERISTIC NVM_command "NVM command: 0x45564153 SAVE, 0x544C4644 load defaults; firmware clears to 0" VALUE 0x70030204 RL_ULONG 4294967295 NO_COMPU_METHOD 0 4294967295 /end CHARACTERISTIC
/begin CHARACTERISTIC NVM_userValue "persistent user scratch word (survives reset after SAVE)" VALUE 0x70030208 RL_ULONG 4294967295 NO_COMPU_METHOD 0 4294967295 /end CHARACTERISTIC
/begin CHARACTERISTIC NVM_seaLevelPa "sea-level reference pressure for BaroAltitude - set to local QNH" VALUE 0x7003020C RL_ULONG 108500 NO_COMPU_METHOD 87000 108500 PHYS_UNIT "Pa" /end CHARACTERISTIC
/* GPIO control: Xcp_Gpio @ 0x70030300, RAM only (see gpio.h) */
/begin CHARACTERISTIC GPIO_P00_01_state "P00.1 output level (0=OFF/low, 1=ON/high)" VALUE 0x70030305 RL_UBYTE 1 NO_COMPU_METHOD 0 1 /end CHARACTERISTIC
/begin CHARACTERISTIC GPIO_P00_02_state "P00.2 output level (0=OFF/low, 1=ON/high)" VALUE 0x70030306 RL_UBYTE 1 NO_COMPU_METHOD 0 1 /end CHARACTERISTIC
/begin CHARACTERISTIC GPIO_P00_03_state "P00.3 output level (0=OFF/low, 1=ON/high)" VALUE 0x70030307 RL_UBYTE 1 NO_COMPU_METHOD 0 1 /end CHARACTERISTIC
/begin CHARACTERISTIC GPIO_P00_04_state "P00.4 output level (0=OFF/low, 1=ON/high)" VALUE 0x70030308 RL_UBYTE 1 NO_COMPU_METHOD 0 1 /end CHARACTERISTIC
/begin CHARACTERISTIC GPIO_P00_05_state "P00.5 output level (0=OFF/low, 1=ON/high)" VALUE 0x70030309 RL_UBYTE 1 NO_COMPU_METHOD 0 1 /end CHARACTERISTIC
/begin CHARACTERISTIC GPIO_P00_06_state "P00.6 output level (0=OFF/low, 1=ON/high)" VALUE 0x7003030A RL_UBYTE 1 NO_COMPU_METHOD 0 1 /end CHARACTERISTIC
/begin CHARACTERISTIC GPIO_P00_07_state "P00.7 output level (0=OFF/low, 1=ON/high)" VALUE 0x7003030B RL_UBYTE 1 NO_COMPU_METHOD 0 1 /end CHARACTERISTIC
/begin CHARACTERISTIC GPIO_P00_08_state "P00.8 output level (0=OFF/low, 1=ON/high)" VALUE 0x7003030C RL_UBYTE 1 NO_COMPU_METHOD 0 1 /end CHARACTERISTIC
/begin CHARACTERISTIC GPIO_P00_09_state "P00.9 output level (0=OFF/low, 1=ON/high)" VALUE 0x7003030D RL_UBYTE 1 NO_COMPU_METHOD 0 1 /end CHARACTERISTIC
/begin CHARACTERISTIC GPIO_P00_10_state "P00.10 output level (0=OFF/low, 1=ON/high)" VALUE 0x7003030E RL_UBYTE 1 NO_COMPU_METHOD 0 1 /end CHARACTERISTIC
/begin CHARACTERISTIC GPIO_P00_11_state "P00.11 output level (0=OFF/low, 1=ON/high)" VALUE 0x7003030F RL_UBYTE 1 NO_COMPU_METHOD 0 1 /end CHARACTERISTIC
/begin CHARACTERISTIC GPIO_P00_12_state "P00.12 output level (0=OFF/low, 1=ON/high)" VALUE 0x70030310 RL_UBYTE 1 NO_COMPU_METHOD 0 1 /end CHARACTERISTIC
/begin CHARACTERISTIC GPIO_P00_13_state "P00.13 output level (0=OFF/low, 1=ON/high)" VALUE 0x70030311 RL_UBYTE 1 NO_COMPU_METHOD 0 1 /end CHARACTERISTIC
/begin CHARACTERISTIC GPIO_P00_14_state "P00.14 output level (0=OFF/low, 1=ON/high)" VALUE 0x70030312 RL_UBYTE 1 NO_COMPU_METHOD 0 1 /end CHARACTERISTIC
/begin CHARACTERISTIC GPIO_P00_15_state "P00.15 output level (0=OFF/low, 1=ON/high)" VALUE 0x70030313 RL_UBYTE 1 NO_COMPU_METHOD 0 1 /end CHARACTERISTIC
/begin CHARACTERISTIC GPIO_P00_01_duty "P00.1 PWM duty cycle (effective only if pin is PWM in gpio_cfg.h)" VALUE 0x70030325 RL_UBYTE 100 NO_COMPU_METHOD 0 100 PHYS_UNIT "%" /end CHARACTERISTIC
/begin CHARACTERISTIC GPIO_P00_02_duty "P00.2 PWM duty cycle (effective only if pin is PWM in gpio_cfg.h)" VALUE 0x70030326 RL_UBYTE 100 NO_COMPU_METHOD 0 100 PHYS_UNIT "%" /end CHARACTERISTIC
/begin CHARACTERISTIC GPIO_P00_03_duty "P00.3 PWM duty cycle (effective only if pin is PWM in gpio_cfg.h)" VALUE 0x70030327 RL_UBYTE 100 NO_COMPU_METHOD 0 100 PHYS_UNIT "%" /end CHARACTERISTIC
/begin CHARACTERISTIC GPIO_P00_04_duty "P00.4 PWM duty cycle (effective only if pin is PWM in gpio_cfg.h)" VALUE 0x70030328 RL_UBYTE 100 NO_COMPU_METHOD 0 100 PHYS_UNIT "%" /end CHARACTERISTIC
/begin CHARACTERISTIC GPIO_P00_05_duty "P00.5 PWM duty cycle (effective only if pin is PWM in gpio_cfg.h)" VALUE 0x70030329 RL_UBYTE 100 NO_COMPU_METHOD 0 100 PHYS_UNIT "%" /end CHARACTERISTIC
/begin CHARACTERISTIC GPIO_P00_06_duty "P00.6 PWM duty cycle (effective only if pin is PWM in gpio_cfg.h)" VALUE 0x7003032A RL_UBYTE 100 NO_COMPU_METHOD 0 100 PHYS_UNIT "%" /end CHARACTERISTIC
/begin CHARACTERISTIC GPIO_P00_07_duty "P00.7 PWM duty cycle (effective only if pin is PWM in gpio_cfg.h)" VALUE 0x7003032B RL_UBYTE 100 NO_COMPU_METHOD 0 100 PHYS_UNIT "%" /end CHARACTERISTIC
/begin CHARACTERISTIC GPIO_P00_08_duty "P00.8 PWM duty cycle (effective only if pin is PWM in gpio_cfg.h)" VALUE 0x7003032C RL_UBYTE 100 NO_COMPU_METHOD 0 100 PHYS_UNIT "%" /end CHARACTERISTIC
/begin CHARACTERISTIC GPIO_P00_09_duty "P00.9 PWM duty cycle (effective only if pin is PWM in gpio_cfg.h)" VALUE 0x7003032D RL_UBYTE 100 NO_COMPU_METHOD 0 100 PHYS_UNIT "%" /end CHARACTERISTIC
/begin CHARACTERISTIC GPIO_P00_10_duty "P00.10 PWM duty cycle (effective only if pin is PWM in gpio_cfg.h)" VALUE 0x7003032E RL_UBYTE 100 NO_COMPU_METHOD 0 100 PHYS_UNIT "%" /end CHARACTERISTIC
/begin CHARACTERISTIC GPIO_P00_11_duty "P00.11 PWM duty cycle (effective only if pin is PWM in gpio_cfg.h)" VALUE 0x7003032F RL_UBYTE 100 NO_COMPU_METHOD 0 100 PHYS_UNIT "%" /end CHARACTERISTIC
/begin CHARACTERISTIC GPIO_P00_12_duty "P00.12 PWM duty cycle (effective only if pin is PWM in gpio_cfg.h)" VALUE 0x70030330 RL_UBYTE 100 NO_COMPU_METHOD 0 100 PHYS_UNIT "%" /end CHARACTERISTIC
/begin CHARACTERISTIC GPIO_P00_13_duty "P00.13 PWM duty cycle (effective only if pin is PWM in gpio_cfg.h)" VALUE 0x70030331 RL_UBYTE 100 NO_COMPU_METHOD 0 100 PHYS_UNIT "%" /end CHARACTERISTIC
/begin CHARACTERISTIC GPIO_P00_14_duty "P00.14 PWM duty cycle (effective only if pin is PWM in gpio_cfg.h)" VALUE 0x70030332 RL_UBYTE 100 NO_COMPU_METHOD 0 100 PHYS_UNIT "%" /end CHARACTERISTIC
/begin CHARACTERISTIC GPIO_P00_15_duty "P00.15 PWM duty cycle (effective only if pin is PWM in gpio_cfg.h)" VALUE 0x70030333 RL_UBYTE 100 NO_COMPU_METHOD 0 100 PHYS_UNIT "%" /end CHARACTERISTIC
/* Navigation state: Xcp_Fusion @ 0x70030500 (see Measurements.h) */
/begin MEASUREMENT NavTickMs "uptime when the navigation block was last written" ULONG NO_COMPU_METHOD 0 0 0 4294967295 ECU_ADDRESS 0x70030504 PHYS_UNIT "ms" /end MEASUREMENT
/begin MEASUREMENT AttRoll "roll angle, positive right side down" FLOAT32_IEEE NO_COMPU_METHOD 0 0 -180 180 ECU_ADDRESS 0x70030508 PHYS_UNIT "deg" /end MEASUREMENT
/begin MEASUREMENT AttPitch "pitch angle, positive nose up; clamped at +/-90" FLOAT32_IEEE NO_COMPU_METHOD 0 0 -90 90 ECU_ADDRESS 0x7003050C PHYS_UNIT "deg" /end MEASUREMENT
/begin MEASUREMENT AttYaw "heading, true north when the NVM declination is set" FLOAT32_IEEE NO_COMPU_METHOD 0 0 0 360 ECU_ADDRESS 0x70030510 PHYS_UNIT "deg" /end MEASUREMENT
/begin MEASUREMENT AttQuat0 "body-to-NED quaternion component 0 (w,x,y,z order)" FLOAT32_IEEE NO_COMPU_METHOD 0 0 -1 1 ECU_ADDRESS 0x70030514 /end MEASUREMENT
/begin MEASUREMENT AttQuat1 "body-to-NED quaternion component 1 (w,x,y,z order)" FLOAT32_IEEE NO_COMPU_METHOD 0 0 -1 1 ECU_ADDRESS 0x70030518 /end MEASUREMENT
/begin MEASUREMENT AttQuat2 "body-to-NED quaternion component 2 (w,x,y,z order)" FLOAT32_IEEE NO_COMPU_METHOD 0 0 -1 1 ECU_ADDRESS 0x7003051C /end MEASUREMENT
/begin MEASUREMENT AttQuat3 "body-to-NED quaternion component 3 (w,x,y,z order)" FLOAT32_IEEE NO_COMPU_METHOD 0 0 -1 1 ECU_ADDRESS 0x70030520 /end MEASUREMENT
/begin MEASUREMENT AttRate0 "bias-corrected body rate about axis 0 (p,q,r)" FLOAT32_IEEE NO_COMPU_METHOD 0 0 -2000 2000 ECU_ADDRESS 0x70030524 PHYS_UNIT "deg/s" /end MEASUREMENT
/begin MEASUREMENT AttRate1 "bias-corrected body rate about axis 1 (p,q,r)" FLOAT32_IEEE NO_COMPU_METHOD 0 0 -2000 2000 ECU_ADDRESS 0x70030528 PHYS_UNIT "deg/s" /end MEASUREMENT
/begin MEASUREMENT AttRate2 "bias-corrected body rate about axis 2 (p,q,r)" FLOAT32_IEEE NO_COMPU_METHOD 0 0 -2000 2000 ECU_ADDRESS 0x7003052C PHYS_UNIT "deg/s" /end MEASUREMENT
/begin MEASUREMENT AttGyroBias0 "estimated gyro bias on axis 0; boot calibration plus tracked drift" FLOAT32_IEEE NO_COMPU_METHOD 0 0 -50 50 ECU_ADDRESS 0x70030530 PHYS_UNIT "deg/s" /end MEASUREMENT
/begin MEASUREMENT AttGyroBias1 "estimated gyro bias on axis 1; boot calibration plus tracked drift" FLOAT32_IEEE NO_COMPU_METHOD 0 0 -50 50 ECU_ADDRESS 0x70030534 PHYS_UNIT "deg/s" /end MEASUREMENT
/begin MEASUREMENT AttGyroBias2 "estimated gyro bias on axis 2; boot calibration plus tracked drift" FLOAT32_IEEE NO_COMPU_METHOD 0 0 -50 50 ECU_ADDRESS 0x70030538 PHYS_UNIT "deg/s" /end MEASUREMENT
/begin MEASUREMENT AttAccNed0 "acceleration along NED axis 0 with gravity removed" FLOAT32_IEEE NO_COMPU_METHOD 0 0 -100 100 ECU_ADDRESS 0x7003053C PHYS_UNIT "m/s^2" /end MEASUREMENT
/begin MEASUREMENT AttAccNed1 "acceleration along NED axis 1 with gravity removed" FLOAT32_IEEE NO_COMPU_METHOD 0 0 -100 100 ECU_ADDRESS 0x70030540 PHYS_UNIT "m/s^2" /end MEASUREMENT
/begin MEASUREMENT AttAccNed2 "acceleration along NED axis 2 with gravity removed" FLOAT32_IEEE NO_COMPU_METHOD 0 0 -100 100 ECU_ADDRESS 0x70030544 PHYS_UNIT "m/s^2" /end MEASUREMENT
/begin MEASUREMENT AttAccMagnitude "|a|, the orientation-independent health check; 1.0 at rest" FLOAT32_IEEE NO_COMPU_METHOD 0 0 0 16 ECU_ADDRESS 0x70030548 PHYS_UNIT "g" /end MEASUREMENT
/begin MEASUREMENT AttMagFieldCorrected "|B| after hard-iron correction; must not change as the board rotates" FLOAT32_IEEE NO_COMPU_METHOD 0 0 0 4 ECU_ADDRESS 0x7003054C PHYS_UNIT "gauss" /end MEASUREMENT
/begin MEASUREMENT AttState "0=calibrating gyro bias, 1=aligning, 2=running, 3=no sensor" UBYTE NO_COMPU_METHOD 0 0 0 3 ECU_ADDRESS 0x70030550 /end MEASUREMENT
/begin MEASUREMENT AttAccTrusted "1 while the continuous accel weight (AttAccWeightPct) is above 0 -- same outer edge as the old hard |a| window (+/-15%), now also gated on angular rate" UBYTE NO_COMPU_METHOD 0 0 0 1 ECU_ADDRESS 0x70030551 /end MEASUREMENT
/begin MEASUREMENT AttMagTrusted "1 while |B| is plausible and is correcting yaw" UBYTE NO_COMPU_METHOD 0 0 0 1 ECU_ADDRESS 0x70030552 /end MEASUREMENT
/begin MEASUREMENT AttAccWeightPct "SYS1-001 strand B (B3.4): continuous accel trust, w_norm*w_rate*100 -- replaces the old hard |a| window. 100 = full trust (|a| within 5% of 1 g AND |gyro| below 30 deg/s); ramps to 0 at the old +/-15% edge or at 120 deg/s, whichever binds first. Scales twoKpAcc's P and I contribution together every tick" UBYTE NO_COMPU_METHOD 0 0 0 100 ECU_ADDRESS 0x70030553 PHYS_UNIT "%" /end MEASUREMENT
/begin MEASUREMENT NavPosDown "position along NED down, relative to the origin; POSITIVE IS DOWN" FLOAT32_IEEE NO_COMPU_METHOD 0 0 -10000 10000 ECU_ADDRESS 0x70030554 PHYS_UNIT "m" /end MEASUREMENT
/begin MEASUREMENT NavVelDown "velocity along NED down; positive is descending" FLOAT32_IEEE NO_COMPU_METHOD 0 0 -100 100 ECU_ADDRESS 0x70030558 PHYS_UNIT "m/s" /end MEASUREMENT
/begin MEASUREMENT NavAccBiasDown "estimated accelerometer bias on the down axis; ~0.01..0.02 on this board" FLOAT32_IEEE NO_COMPU_METHOD 0 0 -5 5 ECU_ADDRESS 0x7003055C PHYS_UNIT "m/s^2" /end MEASUREMENT
/begin MEASUREMENT NavBaroBias "barometer offset against GNSS altitude - the weather drift, not the sensor" FLOAT32_IEEE NO_COMPU_METHOD 0 0 -100 100 ECU_ADDRESS 0x70030560 PHYS_UNIT "m" /end MEASUREMENT
/begin MEASUREMENT NavInnovDown "barometer innovation: what the baro said minus what the filter expected" FLOAT32_IEEE NO_COMPU_METHOD 0 0 -100 100 ECU_ADDRESS 0x70030564 PHYS_UNIT "m" /end MEASUREMENT
/begin MEASUREMENT NavVarDown "variance of PosDown; sqrt of this is the altitude uncertainty" FLOAT32_IEEE NO_COMPU_METHOD 0 0 0 1000000 ECU_ADDRESS 0x70030568 PHYS_UNIT "m^2" /end MEASUREMENT
/begin MEASUREMENT NavPosNorth "metres north of the tangent-plane origin (first usable GNSS fix)" FLOAT32_IEEE NO_COMPU_METHOD 0 0 -100000 100000 ECU_ADDRESS 0x7003056C PHYS_UNIT "m" /end MEASUREMENT
/begin MEASUREMENT NavPosEast "metres east of the tangent-plane origin" FLOAT32_IEEE NO_COMPU_METHOD 0 0 -100000 100000 ECU_ADDRESS 0x70030570 PHYS_UNIT "m" /end MEASUREMENT
/begin MEASUREMENT NavVelNorth "velocity north" FLOAT32_IEEE NO_COMPU_METHOD 0 0 -200 200 ECU_ADDRESS 0x70030574 PHYS_UNIT "m/s" /end MEASUREMENT
/begin MEASUREMENT NavVelEast "velocity east" FLOAT32_IEEE NO_COMPU_METHOD 0 0 -200 200 ECU_ADDRESS 0x70030578 PHYS_UNIT "m/s" /end MEASUREMENT
/begin MEASUREMENT NavAccBiasNorth "estimated accelerometer bias north; mostly absorbs attitude error" FLOAT32_IEEE NO_COMPU_METHOD 0 0 -5 5 ECU_ADDRESS 0x7003057C PHYS_UNIT "m/s^2" /end MEASUREMENT
/begin MEASUREMENT NavAccBiasEast "estimated accelerometer bias east" FLOAT32_IEEE NO_COMPU_METHOD 0 0 -5 5 ECU_ADDRESS 0x70030580 PHYS_UNIT "m/s^2" /end MEASUREMENT
/begin MEASUREMENT NavInnovNorth "GNSS north innovation" FLOAT32_IEEE NO_COMPU_METHOD 0 0 -1000 1000 ECU_ADDRESS 0x70030584 PHYS_UNIT "m" /end MEASUREMENT
/begin MEASUREMENT NavInnovEast "GNSS east innovation" FLOAT32_IEEE NO_COMPU_METHOD 0 0 -1000 1000 ECU_ADDRESS 0x70030588 PHYS_UNIT "m" /end MEASUREMENT
/begin MEASUREMENT NavVarNorth "variance of PosNorth; grows without bound until a GNSS fix arrives" FLOAT32_IEEE NO_COMPU_METHOD 0 0 0 1000000 ECU_ADDRESS 0x7003058C PHYS_UNIT "m^2" /end MEASUREMENT
/begin MEASUREMENT NavOriginLat "latitude of the tangent-plane origin" FLOAT32_IEEE NO_COMPU_METHOD 0 0 -90 90 ECU_ADDRESS 0x70030590 PHYS_UNIT "deg" /end MEASUREMENT
/begin MEASUREMENT NavOriginLon "longitude of the tangent-plane origin" FLOAT32_IEEE NO_COMPU_METHOD 0 0 -180 180 ECU_ADDRESS 0x70030594 PHYS_UNIT "deg" /end MEASUREMENT
/begin MEASUREMENT NavOriginAlt "GNSS altitude at the origin fix, above mean sea level" FLOAT32_IEEE NO_COMPU_METHOD 0 0 -1000 10000 ECU_ADDRESS 0x70030598 PHYS_UNIT "m" /end MEASUREMENT
/begin MEASUREMENT NavBaroRejects "barometer samples rejected by the outlier gate; a rising count is a sensor fault, not a tuning knob" ULONG NO_COMPU_METHOD 0 0 0 4294967295 ECU_ADDRESS 0x7003059C /end MEASUREMENT
/begin MEASUREMENT NavBaroResets "vertical re-acquisitions after a run of rejections; non-zero means the filter diverged and recovered" ULONG NO_COMPU_METHOD 0 0 0 4294967295 ECU_ADDRESS 0x700305A0 /end MEASUREMENT
/begin MEASUREMENT NavGnssRejects "GNSS fixes rejected by the outlier gate" ULONG NO_COMPU_METHOD 0 0 0 4294967295 ECU_ADDRESS 0x700305A4 /end MEASUREMENT
/begin MEASUREMENT NavGnssUpdates "GNSS fixes actually fused; increments once per new iTOW, i.e. 1 Hz with a fix" ULONG NO_COMPU_METHOD 0 0 0 4294967295 ECU_ADDRESS 0x700305A8 /end MEASUREMENT
/begin MEASUREMENT NavVerticalOk "1 once the barometer has anchored the vertical channel" UBYTE NO_COMPU_METHOD 0 0 0 1 ECU_ADDRESS 0x700305AC /end MEASUREMENT
/begin MEASUREMENT NavHorizontalOk "1 once GNSS has anchored the horizontal channels" UBYTE NO_COMPU_METHOD 0 0 0 1 ECU_ADDRESS 0x700305AD /end MEASUREMENT
/begin MEASUREMENT NavOriginSet "1 once a usable fix defined the tangent-plane origin" UBYTE NO_COMPU_METHOD 0 0 0 1 ECU_ADDRESS 0x700305AE /end MEASUREMENT
/begin MEASUREMENT NavCovResets "numerical health-check trips. MUST stay 0 - any other value is a bug, not a tuning problem" ULONG NO_COMPU_METHOD 0 0 0 4294967295 ECU_ADDRESS 0x700305B0 /end MEASUREMENT
/begin MEASUREMENT NavGnssITow "GPS time of week of the last fix actually fused; frozen with gnssUpdates stalled means iTOW is not being decoded" ULONG NO_COMPU_METHOD 0 0 0 4294967295 ECU_ADDRESS 0x700305B4 PHYS_UNIT "ms" /end MEASUREMENT
/begin MEASUREMENT NavGnssDupes "polls that carried an already-fused fix; small but non-zero is healthy, exactly zero or near the poll rate is a fault" ULONG NO_COMPU_METHOD 0 0 0 4294967295 ECU_ADDRESS 0x700305B8 /end MEASUREMENT
/begin MEASUREMENT AttBiasDegraded "1 = the boot gyro-bias calibration hit its 10 s deadline instead of completing a still window, i.e. the board was moving at power-on. The estimate still runs, it is just less good" UBYTE NO_COMPU_METHOD 0 0 0 1 ECU_ADDRESS 0x700305BC /end MEASUREMENT
/begin MEASUREMENT CtrlPhiIst0 "FLIGHT CONTROL FEEDBACK: attitude for att_ctrl_step, element 0 of [roll, pitch, yaw]. RADIANS, not degrees - this is the controller's own unit" FLOAT32_IEEE NO_COMPU_METHOD 0 0 -6.3 6.3 ECU_ADDRESS 0x700305C0 PHYS_UNIT "rad" /end MEASUREMENT
/begin MEASUREMENT CtrlPhiIst1 "FLIGHT CONTROL FEEDBACK: attitude for att_ctrl_step, element 1 of [roll, pitch, yaw]. RADIANS, not degrees - this is the controller's own unit" FLOAT32_IEEE NO_COMPU_METHOD 0 0 -6.3 6.3 ECU_ADDRESS 0x700305C4 PHYS_UNIT "rad" /end MEASUREMENT
/begin MEASUREMENT CtrlPhiIst2 "FLIGHT CONTROL FEEDBACK: attitude for att_ctrl_step, element 2 of [roll, pitch, yaw]. RADIANS, not degrees - this is the controller's own unit" FLOAT32_IEEE NO_COMPU_METHOD 0 0 -6.3 6.3 ECU_ADDRESS 0x700305C8 PHYS_UNIT "rad" /end MEASUREMENT
/begin MEASUREMENT CtrlOmIst0 "FLIGHT CONTROL FEEDBACK: body rate for rate_ctrl_step, element 0 of [p, q, r]. RAD/S" FLOAT32_IEEE NO_COMPU_METHOD 0 0 -35 35 ECU_ADDRESS 0x700305CC PHYS_UNIT "rad/s" /end MEASUREMENT
/begin MEASUREMENT CtrlOmIst1 "FLIGHT CONTROL FEEDBACK: body rate for rate_ctrl_step, element 1 of [p, q, r]. RAD/S" FLOAT32_IEEE NO_COMPU_METHOD 0 0 -35 35 ECU_ADDRESS 0x700305D0 PHYS_UNIT "rad/s" /end MEASUREMENT
/begin MEASUREMENT CtrlOmIst2 "FLIGHT CONTROL FEEDBACK: body rate for rate_ctrl_step, element 2 of [p, q, r]. RAD/S" FLOAT32_IEEE NO_COMPU_METHOD 0 0 -35 35 ECU_ADDRESS 0x700305D4 PHYS_UNIT "rad/s" /end MEASUREMENT
/begin MEASUREMENT CtrlPNedIst0 "FLIGHT CONTROL FEEDBACK: position for pos_ctrl_step, element 0 of [north, east, down]" FLOAT32_IEEE NO_COMPU_METHOD 0 0 -100000 100000 ECU_ADDRESS 0x700305D8 PHYS_UNIT "m" /end MEASUREMENT
/begin MEASUREMENT CtrlPNedIst1 "FLIGHT CONTROL FEEDBACK: position for pos_ctrl_step, element 1 of [north, east, down]" FLOAT32_IEEE NO_COMPU_METHOD 0 0 -100000 100000 ECU_ADDRESS 0x700305DC PHYS_UNIT "m" /end MEASUREMENT
/begin MEASUREMENT CtrlPNedIst2 "FLIGHT CONTROL FEEDBACK: position for pos_ctrl_step, element 2 of [north, east, down]" FLOAT32_IEEE NO_COMPU_METHOD 0 0 -100000 100000 ECU_ADDRESS 0x700305E0 PHYS_UNIT "m" /end MEASUREMENT
/begin MEASUREMENT CtrlVBIst0 "FLIGHT CONTROL FEEDBACK: velocity for pos_ctrl_step, element 0 of [u, v, w]. BODY frame, rotated out of NED by the current attitude - feeding it NED velocity would make the damping term wrong by the heading angle" FLOAT32_IEEE NO_COMPU_METHOD 0 0 -200 200 ECU_ADDRESS 0x700305E4 PHYS_UNIT "m/s" /end MEASUREMENT
/begin MEASUREMENT CtrlVBIst1 "FLIGHT CONTROL FEEDBACK: velocity for pos_ctrl_step, element 1 of [u, v, w]. BODY frame, rotated out of NED by the current attitude - feeding it NED velocity would make the damping term wrong by the heading angle" FLOAT32_IEEE NO_COMPU_METHOD 0 0 -200 200 ECU_ADDRESS 0x700305E8 PHYS_UNIT "m/s" /end MEASUREMENT
/begin MEASUREMENT CtrlVBIst2 "FLIGHT CONTROL FEEDBACK: velocity for pos_ctrl_step, element 2 of [u, v, w]. BODY frame, rotated out of NED by the current attitude - feeding it NED velocity would make the damping term wrong by the heading angle" FLOAT32_IEEE NO_COMPU_METHOD 0 0 -200 200 ECU_ADDRESS 0x700305EC PHYS_UNIT "m/s" /end MEASUREMENT
/begin MEASUREMENT NavDropped "measurements refused at the filter input as NaN, infinite or absurd. MUST be 0 with healthy sensors - a rising count IS a failing sensor. Exists because a bad sample cannot be caught later: the outlier gate cannot see a NaN (every comparison against NaN is false, so it is not an outlier) and the covariance check does not fire either, because P stays finite while the state goes NaN" ULONG NO_COMPU_METHOD 0 0 0 4294967295 ECU_ADDRESS 0x700305F0 /end MEASUREMENT
/begin MEASUREMENT NavInnovVelNorth "last GNSS velocity innovation, north. Published so the velocity NIS (var(y)/(P+R)) becomes computable - see docs/NAV_TUNING.md, which is what motivated the Q reparametrisation this field ships alongside" FLOAT32_IEEE NO_COMPU_METHOD 0 0 -200 200 ECU_ADDRESS 0x700305F4 PHYS_UNIT "m/s" /end MEASUREMENT
/begin MEASUREMENT NavInnovVelEast "last GNSS velocity innovation, east. Published so the velocity NIS (var(y)/(P+R)) becomes computable - see docs/NAV_TUNING.md, which is what motivated the Q reparametrisation this field ships alongside" FLOAT32_IEEE NO_COMPU_METHOD 0 0 -200 200 ECU_ADDRESS 0x700305F8 PHYS_UNIT "m/s" /end MEASUREMENT
/* Estimator tuning: Xcp_FusionCal @ 0x70030600, RAM only (FusionCal.h) */
/begin CHARACTERISTIC FusKpAccel "TUNING - attitude: how hard the accelerometer pulls the gyro integral back toward gravity. Higher = tracks gravity faster but inherits vibration; lower = smoother but gyro drift shows. Fixes ROLL and PITCH only" VALUE 0x70030604 RL_FLOAT32 20 NO_COMPU_METHOD 0 20 PHYS_UNIT "1/s" /end CHARACTERISTIC
/begin CHARACTERISTIC FusKpMag "TUNING - attitude: same, for the magnetometer, which fixes YAW only. Deliberately half the accelerometer gain: indoors the magnetic field is the less trustworthy of the two" VALUE 0x70030608 RL_FLOAT32 20 NO_COMPU_METHOD 0 20 PHYS_UNIT "1/s" /end CHARACTERISTIC
/begin CHARACTERISTIC FusKiGyroBias "TUNING - attitude: integral gain that tracks slow gyro-bias drift. Small, because the boot calibration already removed the bulk of it" VALUE 0x7003060C RL_FLOAT32 1 NO_COMPU_METHOD 0 1 PHYS_UNIT "1/s^2" /end CHARACTERISTIC
/begin CHARACTERISTIC FusSigmaAccDownPsd "TUNING - vertical: how much the filter distrusts the accelerometer when predicting altitude, as a PSD. THE knob to raise once motors are running, because vibration is not in the 0.0424 measured on a desk. RENAMED from FusSigmaAccDown (docs/NAV_TUNING.md): the reparametrisation from a per-tick sigma to a PSD changes the meaning by ~32x at this board's tick rate - a stale saved tuning file under the old name must fail to find this field, not silently write a 32x-wrong value" VALUE 0x70030610 RL_FLOAT32 5 NO_COMPU_METHOD 0.0001 5 PHYS_UNIT "m/s^2/sqrt(Hz)" /end CHARACTERISTIC
/begin CHARACTERISTIC FusSigmaBaro "TUNING - vertical: barometer noise. MEASURED (0.0197 m); R is this value SQUARED. Changing the BMP581 IIR setting invalidates it - re-measure, do not guess" VALUE 0x70030614 RL_FLOAT32 10 NO_COMPU_METHOD 0.001 10 PHYS_UNIT "m" /end CHARACTERISTIC
/begin CHARACTERISTIC FusSigmaBaroDrift "TUNING - vertical: how fast the barometer's zero wanders with weather. Measured 0.19 m/min on a still desk. This is the WEATHER, not the sensor" VALUE 0x70030618 RL_FLOAT32 1 NO_COMPU_METHOD 0 1 PHYS_UNIT "m/sqrt(s)" /end CHARACTERISTIC
/begin CHARACTERISTIC FusTauBaroDrift "TUNING - vertical: time constant over which that barometer drift reverts toward zero. Without mean reversion the altitude variance grows without bound, because a barometer alone can only ever observe (altitude + drift), never either one" VALUE 0x7003061C RL_FLOAT32 10000 NO_COMPU_METHOD 1 10000 PHYS_UNIT "s" /end CHARACTERISTIC
/begin CHARACTERISTIC FusSigmaAccHorizPsd "TUNING - horizontal: accelerometer distrust for north/east, as a PSD. Larger than the vertical one because horizontal acceleration is contaminated by ATTITUDE error - one degree of tilt error tips 0.17 m/s^2 of gravity into the horizontal plane. RENAMED from FusSigmaAccHoriz (docs/NAV_TUNING.md): the reparametrisation from a per-tick sigma to a PSD changes the meaning by ~32x at this board's tick rate - a stale saved tuning file under the old name must fail to find this field, not silently write a 32x-wrong value" VALUE 0x70030620 RL_FLOAT32 5 NO_COMPU_METHOD 0.0001 5 PHYS_UNIT "m/s^2/sqrt(Hz)" /end CHARACTERISTIC
/begin CHARACTERISTIC FusSigmaGnssVel "TUNING - horizontal: GNSS velocity noise. Currently pessimistic at 0.3 against a receiver good to about 0.05 - this is Doppler-derived and is the best measurement available for a position loop" VALUE 0x70030624 RL_FLOAT32 20 NO_COMPU_METHOD 0.001 20 PHYS_UNIT "m/s" /end CHARACTERISTIC
/begin CHARACTERISTIC FusGnssPosRScale "TUNING - horizontal: multiplies the GNSS position R. 1.0 trusts hAcc as a single independent fix, which is WRONG at 10 Hz because consecutive solutions share most of their information. Set to 8.0 after the outdoor run showed varN claiming 0.3 m against a real 2.59 m" VALUE 0x70030628 RL_FLOAT32 1000 NO_COMPU_METHOD 0.1 1000 /end CHARACTERISTIC
/begin CHARACTERISTIC FusGateSigmaSq "TUNING - outlier gate, in sigma SQUARED (25 = 5 sigma). Rejects a measurement this far from what the filter expected" VALUE 0x7003062C RL_FLOAT32 10000 NO_COMPU_METHOD 1 10000 /end CHARACTERISTIC
/begin CHARACTERISTIC FusGateMinMetres "TUNING - absolute floor on the barometer gate. Without it the gate converges to +/-0.1 m and starts rejecting real motion: a 30 cm hand lift already reached 62 percent of it. The gate is for CORRUPT readings, not for manoeuvres" VALUE 0x70030630 RL_FLOAT32 1000 NO_COMPU_METHOD 0.01 1000 PHYS_UNIT "m" /end CHARACTERISTIC
/begin CHARACTERISTIC FusSigmaAccBiasRw "TUNING - accelerometer bias random walk, shared by all three channels. Already rate-invariant (unlike sigmaAccDPsd/sigmaAccHPsd), so this only wires the fusion.c compile-time constant into the live block. Measured: the down-axis bias moved 0.0003 m/s^2 across 60 s at constant temperature" VALUE 0x70030634 RL_FLOAT32 1 NO_COMPU_METHOD 0.000001 1 PHYS_UNIT "m/s^2/sqrt(s)" /end CHARACTERISTIC
/begin CHARACTERISTIC MagCalOff0 "CALIBRATION - magnetometer hard-iron offset on sensor axis 0, subtracted before the mount transform. Compiled default = calibration/board.json (this board, 2026-10-19); RAM-only, a write here is a trial until tools/mag_cal.py --write puts it into FusionCal.c" VALUE 0x70030640 RL_FLOAT32 4 NO_COMPU_METHOD -4 4 PHYS_UNIT "gauss" /end CHARACTERISTIC
/begin CHARACTERISTIC MagCalOff1 "CALIBRATION - magnetometer hard-iron offset on sensor axis 1, subtracted before the mount transform. Compiled default = calibration/board.json (this board, 2026-10-19); RAM-only, a write here is a trial until tools/mag_cal.py --write puts it into FusionCal.c" VALUE 0x70030644 RL_FLOAT32 4 NO_COMPU_METHOD -4 4 PHYS_UNIT "gauss" /end CHARACTERISTIC
/begin CHARACTERISTIC MagCalOff2 "CALIBRATION - magnetometer hard-iron offset on sensor axis 2, subtracted before the mount transform. Compiled default = calibration/board.json (this board, 2026-10-19); RAM-only, a write here is a trial until tools/mag_cal.py --write puts it into FusionCal.c" VALUE 0x70030648 RL_FLOAT32 4 NO_COMPU_METHOD -4 4 PHYS_UNIT "gauss" /end CHARACTERISTIC
/begin CHARACTERISTIC MagCalScale0 "CALIBRATION - magnetometer soft-iron scale on sensor axis 0; 1.0 is no correction. Same provenance as MagCalOff" VALUE 0x7003064C RL_FLOAT32 10 NO_COMPU_METHOD 0.1 10 /end CHARACTERISTIC
/begin CHARACTERISTIC MagCalScale1 "CALIBRATION - magnetometer soft-iron scale on sensor axis 1; 1.0 is no correction. Same provenance as MagCalOff" VALUE 0x70030650 RL_FLOAT32 10 NO_COMPU_METHOD 0.1 10 /end CHARACTERISTIC
/begin CHARACTERISTIC MagCalScale2 "CALIBRATION - magnetometer soft-iron scale on sensor axis 2; 1.0 is no correction. Same provenance as MagCalOff" VALUE 0x70030654 RL_FLOAT32 10 NO_COMPU_METHOD 0.1 10 /end CHARACTERISTIC
/begin CHARACTERISTIC MagCalDeclination "CALIBRATION - magnetic declination, east positive; +3.9 in Munich. Turns magnetic north into true north at the AHRS output" VALUE 0x70030658 RL_FLOAT32 180 NO_COMPU_METHOD -180 180 PHYS_UNIT "deg" /end CHARACTERISTIC
/begin CHARACTERISTIC NotchQ "TUNING - quality of every rpm-tracked notch stage on acc and gyro in front of the AHRS (ImuFilter.c); width = f0 / Q, 5 = 16 Hz wide at 80 Hz. Reader clamps to > 0.5. Takes effect on the next tick" VALUE 0x7003065C RL_FLOAT32 50 NO_COMPU_METHOD 0.5 50 /end CHARACTERISTIC
/begin CHARACTERISTIC NotchEnable "TUNING - bit 0: 1/rev (unbalance) stages, bit 1: 2/rev (blade pass) stages. 3 = both (default), 0 = raw IMU into the AHRS for the before/after comparison on the frame" VALUE 0x70030660 RL_ULONG 3 NO_COMPU_METHOD 0 3 /end CHARACTERISTIC
/begin CHARACTERISTIC AccLpfHz "TUNING - corner of the 2nd-order low-pass on the accelerometer behind the rpm notches, in front of the AHRS gate (ImuFilter.c). 15 = default; 0 (or outside 1..400) = off. Gyro is not low-passed" VALUE 0x70030664 RL_FLOAT32 400 NO_COMPU_METHOD 0 400 PHYS_UNIT "Hz" /end CHARACTERISTIC
/* ESC telemetry: Xcp_Esc @ 0x70030700 (see Measurements.h) */
/begin MEASUREMENT EscTickMs "uptime when the ESC block was last written" ULONG NO_COMPU_METHOD 0 0 0 4294967295 ECU_ADDRESS 0x70030704 PHYS_UNIT "ms" /end MEASUREMENT
/begin MEASUREMENT EscCrcFail "KISS packets with a bad CRC-8 on the shared telemetry wire (not attributable to a motor)" ULONG NO_COMPU_METHOD 0 0 0 4294967295 ECU_ADDRESS 0x70030708 /end MEASUREMENT
/begin MEASUREMENT EscM1TempC "ESC M1 temperature (KISS byte 0)" SLONG NO_COMPU_METHOD 0 0 -40 125 ECU_ADDRESS 0x7003070C PHYS_UNIT "degC" /end MEASUREMENT
/begin MEASUREMENT EscM2TempC "ESC M2 temperature (KISS byte 0)" SLONG NO_COMPU_METHOD 0 0 -40 125 ECU_ADDRESS 0x70030710 PHYS_UNIT "degC" /end MEASUREMENT
/begin MEASUREMENT EscM3TempC "ESC M3 temperature (KISS byte 0)" SLONG NO_COMPU_METHOD 0 0 -40 125 ECU_ADDRESS 0x70030714 PHYS_UNIT "degC" /end MEASUREMENT
/begin MEASUREMENT EscM4TempC "ESC M4 temperature (KISS byte 0)" SLONG NO_COMPU_METHOD 0 0 -40 125 ECU_ADDRESS 0x70030718 PHYS_UNIT "degC" /end MEASUREMENT
/begin MEASUREMENT EscM1TlmCount "CRC-valid KISS packets from ESC M1 since boot" ULONG NO_COMPU_METHOD 0 0 0 4294967295 ECU_ADDRESS 0x7003071C /end MEASUREMENT
/begin MEASUREMENT EscM2TlmCount "CRC-valid KISS packets from ESC M2 since boot" ULONG NO_COMPU_METHOD 0 0 0 4294967295 ECU_ADDRESS 0x70030720 /end MEASUREMENT
/begin MEASUREMENT EscM3TlmCount "CRC-valid KISS packets from ESC M3 since boot" ULONG NO_COMPU_METHOD 0 0 0 4294967295 ECU_ADDRESS 0x70030724 /end MEASUREMENT
/begin MEASUREMENT EscM4TlmCount "CRC-valid KISS packets from ESC M4 since boot" ULONG NO_COMPU_METHOD 0 0 0 4294967295 ECU_ADDRESS 0x70030728 /end MEASUREMENT
/begin MEASUREMENT EscM1TlmMissed "telemetry requests to ESC M1 that got no packet in their slot" ULONG NO_COMPU_METHOD 0 0 0 4294967295 ECU_ADDRESS 0x7003072C /end MEASUREMENT
/begin MEASUREMENT EscM2TlmMissed "telemetry requests to ESC M2 that got no packet in their slot" ULONG NO_COMPU_METHOD 0 0 0 4294967295 ECU_ADDRESS 0x70030730 /end MEASUREMENT
/begin MEASUREMENT EscM3TlmMissed "telemetry requests to ESC M3 that got no packet in their slot" ULONG NO_COMPU_METHOD 0 0 0 4294967295 ECU_ADDRESS 0x70030734 /end MEASUREMENT
/begin MEASUREMENT EscM4TlmMissed "telemetry requests to ESC M4 that got no packet in their slot" ULONG NO_COMPU_METHOD 0 0 0 4294967295 ECU_ADDRESS 0x70030738 /end MEASUREMENT
/begin MEASUREMENT EscM1Rpm "ESC M1 mechanical speed from KISS telemetry, eRpm100*100/(poles/2) with 14 poles (~129 while stopped: AM32 max-period sentinel, see ERpm100)" FLOAT32_IEEE NO_COMPU_METHOD 0 0 0 60000 ECU_ADDRESS 0x7003073C PHYS_UNIT "rpm" /end MEASUREMENT
/begin MEASUREMENT EscM2Rpm "ESC M2 mechanical speed from KISS telemetry, eRpm100*100/(poles/2) with 14 poles (~129 while stopped: AM32 max-period sentinel, see ERpm100)" FLOAT32_IEEE NO_COMPU_METHOD 0 0 0 60000 ECU_ADDRESS 0x70030740 PHYS_UNIT "rpm" /end MEASUREMENT
/begin MEASUREMENT EscM3Rpm "ESC M3 mechanical speed from KISS telemetry, eRpm100*100/(poles/2) with 14 poles (~129 while stopped: AM32 max-period sentinel, see ERpm100)" FLOAT32_IEEE NO_COMPU_METHOD 0 0 0 60000 ECU_ADDRESS 0x70030744 PHYS_UNIT "rpm" /end MEASUREMENT
/begin MEASUREMENT EscM4Rpm "ESC M4 mechanical speed from KISS telemetry, eRpm100*100/(poles/2) with 14 poles (~129 while stopped: AM32 max-period sentinel, see ERpm100)" FLOAT32_IEEE NO_COMPU_METHOD 0 0 0 60000 ECU_ADDRESS 0x70030748 PHYS_UNIT "rpm" /end MEASUREMENT
/begin MEASUREMENT EscM1ERpm100 "ESC M1 electrical rpm / 100, raw KISS field (x100 = eRPM; reads 9 while stopped because AM32 reports its 65408 us max-period sentinel, not 0)" UWORD NO_COMPU_METHOD 0 0 0 65535 ECU_ADDRESS 0x7003074C /end MEASUREMENT
/begin MEASUREMENT EscM2ERpm100 "ESC M2 electrical rpm / 100, raw KISS field (x100 = eRPM; reads 9 while stopped because AM32 reports its 65408 us max-period sentinel, not 0)" UWORD NO_COMPU_METHOD 0 0 0 65535 ECU_ADDRESS 0x7003074E /end MEASUREMENT
/begin MEASUREMENT EscM3ERpm100 "ESC M3 electrical rpm / 100, raw KISS field (x100 = eRPM; reads 9 while stopped because AM32 reports its 65408 us max-period sentinel, not 0)" UWORD NO_COMPU_METHOD 0 0 0 65535 ECU_ADDRESS 0x70030750 /end MEASUREMENT
/begin MEASUREMENT EscM4ERpm100 "ESC M4 electrical rpm / 100, raw KISS field (x100 = eRPM; reads 9 while stopped because AM32 reports its 65408 us max-period sentinel, not 0)" UWORD NO_COMPU_METHOD 0 0 0 65535 ECU_ADDRESS 0x70030752 /end MEASUREMENT
/begin MEASUREMENT EscM1VoltageCv "ESC M1 reported pack voltage [cV] - INVALID on the GOKU G55M (floating ADC), shown raw" UWORD NO_COMPU_METHOD 0 0 0 65535 ECU_ADDRESS 0x70030754 PHYS_UNIT "cV" /end MEASUREMENT
/begin MEASUREMENT EscM2VoltageCv "ESC M2 reported pack voltage [cV] - INVALID on the GOKU G55M (floating ADC), shown raw" UWORD NO_COMPU_METHOD 0 0 0 65535 ECU_ADDRESS 0x70030756 PHYS_UNIT "cV" /end MEASUREMENT
/begin MEASUREMENT EscM3VoltageCv "ESC M3 reported pack voltage [cV] - INVALID on the GOKU G55M (floating ADC), shown raw" UWORD NO_COMPU_METHOD 0 0 0 65535 ECU_ADDRESS 0x70030758 PHYS_UNIT "cV" /end MEASUREMENT
/begin MEASUREMENT EscM4VoltageCv "ESC M4 reported pack voltage [cV] - INVALID on the GOKU G55M (floating ADC), shown raw" UWORD NO_COMPU_METHOD 0 0 0 65535 ECU_ADDRESS 0x7003075A PHYS_UNIT "cV" /end MEASUREMENT
/begin MEASUREMENT EscM1CurrentCa "ESC M1 reported motor current [cA] - INVALID on the GOKU G55M (floating ADC), shown raw" UWORD NO_COMPU_METHOD 0 0 0 65535 ECU_ADDRESS 0x7003075C PHYS_UNIT "cA" /end MEASUREMENT
/begin MEASUREMENT EscM2CurrentCa "ESC M2 reported motor current [cA] - INVALID on the GOKU G55M (floating ADC), shown raw" UWORD NO_COMPU_METHOD 0 0 0 65535 ECU_ADDRESS 0x7003075E PHYS_UNIT "cA" /end MEASUREMENT
/begin MEASUREMENT EscM3CurrentCa "ESC M3 reported motor current [cA] - INVALID on the GOKU G55M (floating ADC), shown raw" UWORD NO_COMPU_METHOD 0 0 0 65535 ECU_ADDRESS 0x70030760 PHYS_UNIT "cA" /end MEASUREMENT
/begin MEASUREMENT EscM4CurrentCa "ESC M4 reported motor current [cA] - INVALID on the GOKU G55M (floating ADC), shown raw" UWORD NO_COMPU_METHOD 0 0 0 65535 ECU_ADDRESS 0x70030762 PHYS_UNIT "cA" /end MEASUREMENT
/begin MEASUREMENT EscM1Mah "ESC M1 consumed charge as integrated by the ESC (from the invalid current)" UWORD NO_COMPU_METHOD 0 0 0 65535 ECU_ADDRESS 0x70030764 PHYS_UNIT "mAh" /end MEASUREMENT
/begin MEASUREMENT EscM2Mah "ESC M2 consumed charge as integrated by the ESC (from the invalid current)" UWORD NO_COMPU_METHOD 0 0 0 65535 ECU_ADDRESS 0x70030766 PHYS_UNIT "mAh" /end MEASUREMENT
/begin MEASUREMENT EscM3Mah "ESC M3 consumed charge as integrated by the ESC (from the invalid current)" UWORD NO_COMPU_METHOD 0 0 0 65535 ECU_ADDRESS 0x70030768 PHYS_UNIT "mAh" /end MEASUREMENT
/begin MEASUREMENT EscM4Mah "ESC M4 consumed charge as integrated by the ESC (from the invalid current)" UWORD NO_COMPU_METHOD 0 0 0 65535 ECU_ADDRESS 0x7003076A PHYS_UNIT "mAh" /end MEASUREMENT
/begin MEASUREMENT EscMotorState "arming state machine (Motor_states_t): 0 disarmed, 1 init (beeps), 2 armed, 3 failsafe" UBYTE NO_COMPU_METHOD 0 0 0 3 ECU_ADDRESS 0x7003076C /end MEASUREMENT
/begin MEASUREMENT EscM1Alive "1 = ESC M1 answered its recent telemetry requests" UBYTE NO_COMPU_METHOD 0 0 0 1 ECU_ADDRESS 0x7003076D /end MEASUREMENT
/begin MEASUREMENT EscM2Alive "1 = ESC M2 answered its recent telemetry requests" UBYTE NO_COMPU_METHOD 0 0 0 1 ECU_ADDRESS 0x7003076E /end MEASUREMENT
/begin MEASUREMENT EscM3Alive "1 = ESC M3 answered its recent telemetry requests" UBYTE NO_COMPU_METHOD 0 0 0 1 ECU_ADDRESS 0x7003076F /end MEASUREMENT
/begin MEASUREMENT EscM4Alive "1 = ESC M4 answered its recent telemetry requests" UBYTE NO_COMPU_METHOD 0 0 0 1 ECU_ADDRESS 0x70030770 /end MEASUREMENT
/begin MEASUREMENT EscM1Edges "ESC M1 edges captured in the last bidir DShot reply window (16..22 for a complete GCR burst)" UBYTE NO_COMPU_METHOD 0 0 0 255 ECU_ADDRESS 0x70030771 /end MEASUREMENT
/begin MEASUREMENT EscM2Edges "ESC M2 edges captured in the last bidir DShot reply window (16..22 for a complete GCR burst)" UBYTE NO_COMPU_METHOD 0 0 0 255 ECU_ADDRESS 0x70030772 /end MEASUREMENT
/begin MEASUREMENT EscM3Edges "ESC M3 edges captured in the last bidir DShot reply window (16..22 for a complete GCR burst)" UBYTE NO_COMPU_METHOD 0 0 0 255 ECU_ADDRESS 0x70030773 /end MEASUREMENT
/begin MEASUREMENT EscM4Edges "ESC M4 edges captured in the last bidir DShot reply window (16..22 for a complete GCR burst)" UBYTE NO_COMPU_METHOD 0 0 0 255 ECU_ADDRESS 0x70030774 /end MEASUREMENT
/begin MEASUREMENT EscM1BidirErpm "ESC M1 electrical rpm from the bidirectional DShot reply (answered every 1 kHz frame; 0 while stopped - the ESC's 65408 us max-period sentinel is mapped to 0 - and 0 until the first valid reply)" ULONG NO_COMPU_METHOD 0 0 0 500000 ECU_ADDRESS 0x70030778 PHYS_UNIT "eRPM" /end MEASUREMENT
/begin MEASUREMENT EscM2BidirErpm "ESC M2 electrical rpm from the bidirectional DShot reply (answered every 1 kHz frame; 0 while stopped - the ESC's 65408 us max-period sentinel is mapped to 0 - and 0 until the first valid reply)" ULONG NO_COMPU_METHOD 0 0 0 500000 ECU_ADDRESS 0x7003077C PHYS_UNIT "eRPM" /end MEASUREMENT
/begin MEASUREMENT EscM3BidirErpm "ESC M3 electrical rpm from the bidirectional DShot reply (answered every 1 kHz frame; 0 while stopped - the ESC's 65408 us max-period sentinel is mapped to 0 - and 0 until the first valid reply)" ULONG NO_COMPU_METHOD 0 0 0 500000 ECU_ADDRESS 0x70030780 PHYS_UNIT "eRPM" /end MEASUREMENT
/begin MEASUREMENT EscM4BidirErpm "ESC M4 electrical rpm from the bidirectional DShot reply (answered every 1 kHz frame; 0 while stopped - the ESC's 65408 us max-period sentinel is mapped to 0 - and 0 until the first valid reply)" ULONG NO_COMPU_METHOD 0 0 0 500000 ECU_ADDRESS 0x70030784 PHYS_UNIT "eRPM" /end MEASUREMENT
/begin MEASUREMENT EscM1BidirRpm "ESC M1 mechanical speed from the bidir DShot reply, eRPM/(poles/2) with 14 poles - compare with EscM1Rpm (KISS)" FLOAT32_IEEE NO_COMPU_METHOD 0 0 0 60000 ECU_ADDRESS 0x70030788 PHYS_UNIT "rpm" /end MEASUREMENT
/begin MEASUREMENT EscM2BidirRpm "ESC M2 mechanical speed from the bidir DShot reply, eRPM/(poles/2) with 14 poles - compare with EscM2Rpm (KISS)" FLOAT32_IEEE NO_COMPU_METHOD 0 0 0 60000 ECU_ADDRESS 0x7003078C PHYS_UNIT "rpm" /end MEASUREMENT
/begin MEASUREMENT EscM3BidirRpm "ESC M3 mechanical speed from the bidir DShot reply, eRPM/(poles/2) with 14 poles - compare with EscM3Rpm (KISS)" FLOAT32_IEEE NO_COMPU_METHOD 0 0 0 60000 ECU_ADDRESS 0x70030790 PHYS_UNIT "rpm" /end MEASUREMENT
/begin MEASUREMENT EscM4BidirRpm "ESC M4 mechanical speed from the bidir DShot reply, eRPM/(poles/2) with 14 poles - compare with EscM4Rpm (KISS)" FLOAT32_IEEE NO_COMPU_METHOD 0 0 0 60000 ECU_ADDRESS 0x70030794 PHYS_UNIT "rpm" /end MEASUREMENT
/begin MEASUREMENT EscM1BidirOk "CRC-valid bidir DShot replies from ESC M1 since boot - must count at ~1000/s while the stream runs" ULONG NO_COMPU_METHOD 0 0 0 4294967295 ECU_ADDRESS 0x70030798 /end MEASUREMENT
/begin MEASUREMENT EscM2BidirOk "CRC-valid bidir DShot replies from ESC M2 since boot - must count at ~1000/s while the stream runs" ULONG NO_COMPU_METHOD 0 0 0 4294967295 ECU_ADDRESS 0x7003079C /end MEASUREMENT
/begin MEASUREMENT EscM3BidirOk "CRC-valid bidir DShot replies from ESC M3 since boot - must count at ~1000/s while the stream runs" ULONG NO_COMPU_METHOD 0 0 0 4294967295 ECU_ADDRESS 0x700307A0 /end MEASUREMENT
/begin MEASUREMENT EscM4BidirOk "CRC-valid bidir DShot replies from ESC M4 since boot - must count at ~1000/s while the stream runs" ULONG NO_COMPU_METHOD 0 0 0 4294967295 ECU_ADDRESS 0x700307A4 /end MEASUREMENT
/begin MEASUREMENT EscM1DshotCmd "DShot value sent to ESC M1 in the last frame, as the driver put it on the wire: 0 = motor stop, 1..47 = special commands (beeps), 48..2047 = throttle (48 = minimum), 0 while the stream is off" UWORD NO_COMPU_METHOD 0 0 0 2047 ECU_ADDRESS 0x700307A8 /end MEASUREMENT
/begin MEASUREMENT EscM2DshotCmd "DShot value sent to ESC M2 in the last frame, as the driver put it on the wire: 0 = motor stop, 1..47 = special commands (beeps), 48..2047 = throttle (48 = minimum), 0 while the stream is off" UWORD NO_COMPU_METHOD 0 0 0 2047 ECU_ADDRESS 0x700307AA /end MEASUREMENT
/begin MEASUREMENT EscM3DshotCmd "DShot value sent to ESC M3 in the last frame, as the driver put it on the wire: 0 = motor stop, 1..47 = special commands (beeps), 48..2047 = throttle (48 = minimum), 0 while the stream is off" UWORD NO_COMPU_METHOD 0 0 0 2047 ECU_ADDRESS 0x700307AC /end MEASUREMENT
/begin MEASUREMENT EscM4DshotCmd "DShot value sent to ESC M4 in the last frame, as the driver put it on the wire: 0 = motor stop, 1..47 = special commands (beeps), 48..2047 = throttle (48 = minimum), 0 while the stream is off" UWORD NO_COMPU_METHOD 0 0 0 2047 ECU_ADDRESS 0x700307AE /end MEASUREMENT
/begin MEASUREMENT CtrlM1Rpm "flight controller rotor-speed request for M1; reaches the motor only while ARMED with CAL_ctrlMode = 1 - compare with EscM1BidirRpm" FLOAT32_IEEE NO_COMPU_METHOD 0 0 0 10000 ECU_ADDRESS 0x700307B0 PHYS_UNIT "rpm" /end MEASUREMENT
/begin MEASUREMENT CtrlM2Rpm "flight controller rotor-speed request for M2; reaches the motor only while ARMED with CAL_ctrlMode = 1 - compare with EscM2BidirRpm" FLOAT32_IEEE NO_COMPU_METHOD 0 0 0 10000 ECU_ADDRESS 0x700307B4 PHYS_UNIT "rpm" /end MEASUREMENT
/begin MEASUREMENT CtrlM3Rpm "flight controller rotor-speed request for M3; reaches the motor only while ARMED with CAL_ctrlMode = 1 - compare with EscM3BidirRpm" FLOAT32_IEEE NO_COMPU_METHOD 0 0 0 10000 ECU_ADDRESS 0x700307B8 PHYS_UNIT "rpm" /end MEASUREMENT
/begin MEASUREMENT CtrlM4Rpm "flight controller rotor-speed request for M4; reaches the motor only while ARMED with CAL_ctrlMode = 1 - compare with EscM4BidirRpm" FLOAT32_IEEE NO_COMPU_METHOD 0 0 0 10000 ECU_ADDRESS 0x700307BC PHYS_UNIT "rpm" /end MEASUREMENT
/begin MEASUREMENT CtrlTau_0 "flight controller torque demand (index 0 roll, 1 pitch, 2 yaw)" FLOAT32_IEEE NO_COMPU_METHOD 0 0 -2 2 ECU_ADDRESS 0x700307C0 PHYS_UNIT "Nm" /end MEASUREMENT
/begin MEASUREMENT CtrlTau_1 "flight controller torque demand (index 0 roll, 1 pitch, 2 yaw)" FLOAT32_IEEE NO_COMPU_METHOD 0 0 -2 2 ECU_ADDRESS 0x700307C4 PHYS_UNIT "Nm" /end MEASUREMENT
/begin MEASUREMENT CtrlTau_2 "flight controller torque demand (index 0 roll, 1 pitch, 2 yaw)" FLOAT32_IEEE NO_COMPU_METHOD 0 0 -2 2 ECU_ADDRESS 0x700307C8 PHYS_UNIT "Nm" /end MEASUREMENT
/begin MEASUREMENT CtrlOmSoll_0 "flight controller rate setpoint (index 0 roll, 1 pitch, 2 yaw)" FLOAT32_IEEE NO_COMPU_METHOD 0 0 -40 40 ECU_ADDRESS 0x700307CC PHYS_UNIT "rad/s" /end MEASUREMENT
/begin MEASUREMENT CtrlOmSoll_1 "flight controller rate setpoint (index 0 roll, 1 pitch, 2 yaw)" FLOAT32_IEEE NO_COMPU_METHOD 0 0 -40 40 ECU_ADDRESS 0x700307D0 PHYS_UNIT "rad/s" /end MEASUREMENT
/begin MEASUREMENT CtrlOmSoll_2 "flight controller rate setpoint (index 0 roll, 1 pitch, 2 yaw)" FLOAT32_IEEE NO_COMPU_METHOD 0 0 -40 40 ECU_ADDRESS 0x700307D4 PHYS_UNIT "rad/s" /end MEASUREMENT
/begin MEASUREMENT CtrlTauI_0 "flight controller rate-loop integrator (index 0 roll, 1 pitch, 2 yaw); 0 in shadow" FLOAT32_IEEE NO_COMPU_METHOD 0 0 -2 2 ECU_ADDRESS 0x700307D8 PHYS_UNIT "Nm" /end MEASUREMENT
/begin MEASUREMENT CtrlTauI_1 "flight controller rate-loop integrator (index 0 roll, 1 pitch, 2 yaw); 0 in shadow" FLOAT32_IEEE NO_COMPU_METHOD 0 0 -2 2 ECU_ADDRESS 0x700307DC PHYS_UNIT "Nm" /end MEASUREMENT
/begin MEASUREMENT CtrlTauI_2 "flight controller rate-loop integrator (index 0 roll, 1 pitch, 2 yaw); 0 in shadow" FLOAT32_IEEE NO_COMPU_METHOD 0 0 -2 2 ECU_ADDRESS 0x700307E0 PHYS_UNIT "Nm" /end MEASUREMENT
/begin MEASUREMENT CtrlStatus "flight controller status bits: 1 = driving (integrator live), 2 = navigation estimate invalid, 4 = tilt limit exceeded, 8 = flight core silent (no controller output for 5 ms)" ULONG NO_COMPU_METHOD 0 0 0 15 ECU_ADDRESS 0x700307E4 /end MEASUREMENT
/begin MEASUREMENT CtrlTrips "times the firmware dropped CAL_ctrlMode to 0 because the controller request was unusable, since boot" ULONG NO_COMPU_METHOD 0 0 0 4294967295 ECU_ADDRESS 0x700307E8 /end MEASUREMENT
/begin MEASUREMENT CtrlAttSp_0 "attitude setpoint in force (index 0 roll, 1 pitch, 2 yaw) - compare with AttRoll / AttPitch / AttYaw; yaw equals the current heading while no heading setpoint is given" FLOAT32_IEEE NO_COMPU_METHOD 0 0 -90 360 ECU_ADDRESS 0x700307EC PHYS_UNIT "deg" /end MEASUREMENT
/begin MEASUREMENT CtrlAttSp_1 "attitude setpoint in force (index 0 roll, 1 pitch, 2 yaw) - compare with AttRoll / AttPitch / AttYaw; yaw equals the current heading while no heading setpoint is given" FLOAT32_IEEE NO_COMPU_METHOD 0 0 -90 360 ECU_ADDRESS 0x700307F0 PHYS_UNIT "deg" /end MEASUREMENT
/begin MEASUREMENT CtrlAttSp_2 "attitude setpoint in force (index 0 roll, 1 pitch, 2 yaw) - compare with AttRoll / AttPitch / AttYaw; yaw equals the current heading while no heading setpoint is given" FLOAT32_IEEE NO_COMPU_METHOD 0 0 -90 360 ECU_ADDRESS 0x700307F4 PHYS_UNIT "deg" /end MEASUREMENT
/begin MEASUREMENT CtrlTripReason "reason of the last forced drop of CAL_ctrlMode (CtrlTrips): 2 = navigation estimate invalid, 4 = tilt limit exceeded, 8 = flight core silent; latched until the next drop, 0 = none since boot" ULONG NO_COMPU_METHOD 0 0 0 15 ECU_ADDRESS 0x700307F8 /end MEASUREMENT
/begin MEASUREMENT CtrlMode "CAL_ctrlMode as in force: 0 = shadow, 1 = the controller drives the motors (same word as the calibration, published as a measurement so it is sampled with the rest)" ULONG NO_COMPU_METHOD 0 0 0 1 ECU_ADDRESS 0x700307FC /end MEASUREMENT
/end MODULE
/end PROJECT
